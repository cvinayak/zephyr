## CMakeLists.txt
```
# SPDX-License-Identifier: Apache-2.0

cmake_minimum_required(VERSION 3.20.0)

find_package(Zephyr REQUIRED HINTS $ENV{ZEPHYR_BASE})
project(bsim_test_pawr)

target_sources(app PRIVATE src/main.c)

zephyr_include_directories(
  ${BSIM_COMPONENTS_PATH}/libUtilv1/src/
  ${BSIM_COMPONENTS_PATH}/libPhyComv1/src/
  ${ZEPHYR_BASE}/subsys/bluetooth/controller/include
  )
```

## prj.conf
```kconfig
CONFIG_BT=y
CONFIG_BT_DEVICE_NAME="PAwR"
CONFIG_BT_BROADCASTER=y
CONFIG_BT_PERIPHERAL=y
CONFIG_BT_OBSERVER=y
CONFIG_BT_CENTRAL=y

CONFIG_BT_EXT_ADV=y
CONFIG_BT_PER_ADV=y
CONFIG_BT_PER_ADV_SYNC=y

# Enable PAwR (Periodic Advertising with Responses)
CONFIG_BT_PER_ADV_RSP=y
CONFIG_BT_PER_ADV_SYNC_RSP=y

CONFIG_BT_ID_MAX=2
CONFIG_BT_EXT_ADV_MAX_ADV_SET=2
CONFIG_BT_PER_ADV_SYNC_MAX=2

CONFIG_BT_CTLR_PRIVACY=y
CONFIG_BT_CTLR_ADV_EXT=y
CONFIG_BT_CTLR_ADV_PERIODIC=y
CONFIG_BT_CTLR_SYNC_PERIODIC=y

# Enable PAwR in controller
CONFIG_BT_CTLR_ADV_PERIODIC_RSP=y
CONFIG_BT_CTLR_SYNC_PERIODIC_RSP=y
```

## src/main.c
```c
/* main.c - PAwR (Periodic Advertising with Responses) test */

/*
 * Copyright (c) 2024 Nordic Semiconductor ASA
 *
 * SPDX-License-Identifier: Apache-2.0
 */

#include <stddef.h>

#include <zephyr/types.h>
#include <zephyr/sys/printk.h>
#include <zephyr/sys/util.h>

#include <zephyr/bluetooth/bluetooth.h>
#include <zephyr/bluetooth/hci.h>
#include <zephyr/bluetooth/hci_types.h>

#include "bs_types.h"
#include "bs_tracing.h"
#include "time_machine.h"
#include "bstests.h"

#define FAIL(...)					\
	do {						\
		bst_result = Failed;			\
		bs_trace_error_time_line(__VA_ARGS__);	\
	} while (0)

#define PASS(...)					\
	do {						\
		bst_result = Passed;			\
		bs_trace_info_time(1, __VA_ARGS__);	\
	} while (0)

extern enum bst_result_t bst_result;

/* Test parameters */
#define ADV_INTERVAL            0x00A0  /* 100 ms */
#define PER_ADV_INTERVAL_MIN    0x00A0  /* 200 ms */
#define PER_ADV_INTERVAL_MAX    0x00A0  /* 200 ms */
#define NUM_SUBEVENTS           1       /* Start with 1 subevent */
#define SUBEVENT_INTERVAL       0x10    /* 20 ms in 1.25ms units */
#define RESPONSE_SLOT_DELAY     0x02    /* 2.5 ms in 1.25ms units */
#define RESPONSE_SLOT_SPACING   0x04    /* 0.5 ms in 0.125ms units */
#define NUM_RESPONSE_SLOTS      1

#define SCAN_INTERVAL           0x0040
#define SCAN_WINDOW             0x0040

static const uint8_t test_subevent_data[] = {
	0x02, 0x01, 0x06,  /* Flags */
	0x05, 0x09, 'P', 'A', 'w', 'R'  /* Complete local name */
};

/* State tracking */
static bool adv_started;
static bool sync_established;
static bool sync_report_received;
static uint8_t sync_report_data[256];
static uint8_t sync_report_len;

/* Extended advertising callbacks */
static void adv_sent_cb(struct bt_le_ext_adv *adv,
			struct bt_le_ext_adv_sent_info *info)
{
	printk("Advertising sent, num_sent: %u\n", info->num_sent);
}

static void adv_connected_cb(struct bt_le_ext_adv *adv,
			     struct bt_le_ext_adv_connected_info *info)
{
	printk("Connected\n");
}

static void adv_scanned_cb(struct bt_le_ext_adv *adv,
			   struct bt_le_ext_adv_scanned_info *info)
{
	printk("Scanned\n");
}

#if defined(CONFIG_BT_PER_ADV_RSP)
static void pawr_data_request_cb(struct bt_le_ext_adv *adv,
				 const struct bt_le_per_adv_data_request *request)
{
	printk("PAwR data request: start=%u, count=%u\n",
	       request->start, request->count);
}

static void pawr_response_cb(struct bt_le_ext_adv *adv,
			     struct bt_le_per_adv_response_info *info,
			     struct net_buf_simple *buf)
{
	if (buf) {
		printk("PAwR response received: subevent=%u, slot=%u, len=%u\n",
		       info->subevent, info->response_slot, buf->len);
	}
}
#endif /* CONFIG_BT_PER_ADV_RSP */

static struct bt_le_ext_adv_cb adv_callbacks = {
	.sent = adv_sent_cb,
	.connected = adv_connected_cb,
	.scanned = adv_scanned_cb,
#if defined(CONFIG_BT_PER_ADV_RSP)
	.pawr_data_request = pawr_data_request_cb,
	.pawr_response = pawr_response_cb,
#endif
};

/* Periodic advertising sync callbacks */
static void sync_cb(struct bt_le_per_adv_sync *sync,
		   struct bt_le_per_adv_sync_synced_info *info)
{
	printk("Periodic advertising synced\n");
	sync_established = true;
}

static void term_cb(struct bt_le_per_adv_sync *sync,
		   const struct bt_le_per_adv_sync_term_info *info)
{
	printk("Periodic advertising sync terminated\n");
	sync_established = false;
}

static void recv_cb(struct bt_le_per_adv_sync *sync,
		   const struct bt_le_per_adv_sync_recv_info *info,
		   struct net_buf_simple *buf)
{
	printk("Periodic advertising report: len=%u\n", buf->len);
	if (buf->len > 0) {
		sync_report_len = buf->len;
		memcpy(sync_report_data, buf->data, buf->len);
		sync_report_received = true;
	}
}

static struct bt_le_per_adv_sync_cb sync_callbacks = {
	.synced = sync_cb,
	.term = term_cb,
	.recv = recv_cb,
};

/*
 * PAwR Advertiser Test
 * Tests the advertiser side of Periodic Advertising with Responses
 */
static void test_pawr_adv_main(void)
{
	struct bt_le_ext_adv *adv;
	struct bt_le_adv_param adv_param;
	struct bt_le_per_adv_param per_adv_param;
	int err;

	printk("Starting PAwR Advertiser test\n");

	printk("Initializing Bluetooth...");
	err = bt_enable(NULL);
	if (err) {
		FAIL("Bluetooth init failed (err %d)\n", err);
		return;
	}
	printk("success.\n");

	printk("Creating extended advertising set...");
	memset(&adv_param, 0, sizeof(adv_param));
	adv_param.id = BT_ID_DEFAULT;
	adv_param.options = BT_LE_ADV_OPT_EXT_ADV;
	adv_param.interval_min = ADV_INTERVAL;
	adv_param.interval_max = ADV_INTERVAL;

	err = bt_le_ext_adv_create(&adv_param, &adv_callbacks, &adv);
	if (err) {
		FAIL("Failed to create advertising set (err %d)\n", err);
		return;
	}
	printk("success.\n");

	printk("Setting periodic advertising parameters with PAwR...");
	memset(&per_adv_param, 0, sizeof(per_adv_param));
	per_adv_param.interval_min = PER_ADV_INTERVAL_MIN;
	per_adv_param.interval_max = PER_ADV_INTERVAL_MAX;
	per_adv_param.options = BT_LE_PER_ADV_OPT_NONE;

#if defined(CONFIG_BT_PER_ADV_RSP)
	/* Set PAwR parameters */
	per_adv_param.num_subevents = NUM_SUBEVENTS;
	per_adv_param.subevent_interval = SUBEVENT_INTERVAL;
	per_adv_param.response_slot_delay = RESPONSE_SLOT_DELAY;
	per_adv_param.response_slot_spacing = RESPONSE_SLOT_SPACING;
	per_adv_param.num_response_slots = NUM_RESPONSE_SLOTS;
#endif

	err = bt_le_per_adv_set_param(adv, &per_adv_param);
	if (err) {
		FAIL("Failed to set periodic advertising parameters (err %d)\n", err);
		return;
	}
	printk("success.\n");

#if defined(CONFIG_BT_PER_ADV_RSP)
	printk("Setting subevent data...");
	/* Prepare subevent data parameters */
	struct bt_le_per_adv_subevent_data_params subevent_params;
	struct net_buf_simple subevent_buf;

	subevent_params.subevent = 0;
	subevent_params.response_slot_start = 0;
	subevent_params.response_slot_count = NUM_RESPONSE_SLOTS;

	net_buf_simple_init_with_data(&subevent_buf, (void *)test_subevent_data,
				       sizeof(test_subevent_data));
	subevent_params.data = &subevent_buf;

	err = bt_le_per_adv_set_subevent_data(adv, 1, &subevent_params);
	if (err) {
		FAIL("Failed to set subevent data (err %d)\n", err);
		return;
	}
	printk("success.\n");
#endif

	printk("Starting extended advertising...");
	err = bt_le_ext_adv_start(adv, BT_LE_EXT_ADV_START_DEFAULT);
	if (err) {
		FAIL("Failed to start extended advertising (err %d)\n", err);
		return;
	}
	printk("success.\n");

	printk("Starting periodic advertising...");
	err = bt_le_per_adv_start(adv);
	if (err) {
		FAIL("Failed to start periodic advertising (err %d)\n", err);
		return;
	}
	adv_started = true;
	printk("success.\n");

	printk("Advertising for 5 seconds...\n");
	k_sleep(K_SECONDS(5));

	printk("Stopping periodic advertising...");
	err = bt_le_per_adv_stop(adv);
	if (err) {
		FAIL("Failed to stop periodic advertising (err %d)\n", err);
		return;
	}
	printk("success.\n");

	printk("Stopping extended advertising...");
	err = bt_le_ext_adv_stop(adv);
	if (err) {
		FAIL("Failed to stop extended advertising (err %d)\n", err);
		return;
	}
	printk("success.\n");

	printk("Deleting advertising set...");
	err = bt_le_ext_adv_delete(adv);
	if (err) {
		FAIL("Failed to delete advertising set (err %d)\n", err);
		return;
	}
	printk("success.\n");

	PASS("PAwR Advertiser test passed\n");
}

/*
 * PAwR Scanner/Sync Test
 * Tests the scanner/sync side of Periodic Advertising with Responses
 */
static void test_pawr_sync_main(void)
{
	struct bt_le_per_adv_sync *sync;
	struct bt_le_per_adv_sync_param sync_create_param;
	struct bt_le_scan_param scan_param;
	int err;

	printk("Starting PAwR Sync test\n");

	printk("Initializing Bluetooth...");
	err = bt_enable(NULL);
	if (err) {
		FAIL("Bluetooth init failed (err %d)\n", err);
		return;
	}
	printk("success.\n");

	printk("Registering sync callbacks...");
	bt_le_per_adv_sync_cb_register(&sync_callbacks);
	printk("success.\n");

	printk("Starting scanning...");
	memset(&scan_param, 0, sizeof(scan_param));
	scan_param.type = BT_LE_SCAN_TYPE_ACTIVE;
	scan_param.options = BT_LE_SCAN_OPT_FILTER_DUPLICATE;
	scan_param.interval = SCAN_INTERVAL;
	scan_param.window = SCAN_WINDOW;

	err = bt_le_scan_start(&scan_param, NULL);
	if (err) {
		FAIL("Failed to start scanning (err %d)\n", err);
		return;
	}
	printk("success.\n");

	printk("Waiting for advertiser to start...\n");
	k_sleep(K_SECONDS(2));

	printk("Creating periodic advertising sync...");
	memset(&sync_create_param, 0, sizeof(sync_create_param));
	sync_create_param.sid = 0;
	sync_create_param.timeout = 1000;  /* 10 seconds */
	sync_create_param.skip = 0;

	err = bt_le_per_adv_sync_create(&sync_create_param, &sync);
	if (err) {
		FAIL("Failed to create sync (err %d)\n", err);
		return;
	}
	printk("success.\n");

	printk("Waiting for sync establishment...\n");
	for (int i = 0; i < 50 && !sync_established; i++) {
		k_sleep(K_MSEC(100));
	}

	if (!sync_established) {
		FAIL("Failed to establish sync\n");
		return;
	}
	printk("Sync established.\n");

#if defined(CONFIG_BT_PER_ADV_SYNC_RSP)
	printk("Setting subevent selection...");
	/* Use Host API to select subevents */
	struct bt_le_per_adv_sync_subevent_params subevent_params;
	uint8_t subevents[] = {0};  /* Select subevent 0 */

	subevent_params.properties = 0;
	subevent_params.num_subevents = 1;
	subevent_params.subevents = subevents;

	err = bt_le_per_adv_sync_subevent(sync, &subevent_params);
	if (err) {
		printk("Note: subevent selection returned %d (may not be implemented yet)\n", err);
	} else {
		printk("success.\n");
	}
#endif

	printk("Waiting for periodic advertising reports...\n");
	for (int i = 0; i < 30 && !sync_report_received; i++) {
		k_sleep(K_MSEC(100));
	}

	if (!sync_report_received) {
		printk("Warning: No periodic advertising reports received (may be normal for stub implementation)\n");
	} else {
		printk("Received periodic advertising report of %u bytes\n", sync_report_len);
	}

	printk("Deleting periodic advertising sync...");
	err = bt_le_per_adv_sync_delete(sync);
	if (err) {
		FAIL("Failed to delete sync (err %d)\n", err);
		return;
	}
	printk("success.\n");

	printk("Stopping scan...");
	err = bt_le_scan_stop();
	if (err) {
		FAIL("Failed to stop scan (err %d)\n", err);
		return;
	}
	printk("success.\n");

	PASS("PAwR Sync test passed\n");
}

static void test_pawr_init(void)
{
	bst_ticker_set_next_tick_absolute(30e6);
	bst_result = In_progress;
}

static void test_pawr_tick(bs_time_t HW_device_time)
{
	bst_result = Failed;
	bs_trace_error_line("Test pawr finished.\n");
}

static const struct bst_test_instance test_def[] = {
	{
		.test_id = "pawr_adv",
		.test_descr = "PAwR Advertiser",
		.test_pre_init_f = test_pawr_init,
		.test_tick_f = test_pawr_tick,
		.test_main_f = test_pawr_adv_main
	},
	{
		.test_id = "pawr_sync",
		.test_descr = "PAwR Sync/Scanner",
		.test_pre_init_f = test_pawr_init,
		.test_tick_f = test_pawr_tick,
		.test_main_f = test_pawr_sync_main
	},
	BSTEST_END_MARKER
};

struct bst_test_list *test_pawr_install(struct bst_test_list *tests)
{
	return bst_add_tests(tests, test_def);
}

bst_test_install_t test_installers[] = {
	test_pawr_install,
	NULL
};

int main(void)
{
	bst_main();
	return 0;
}
```

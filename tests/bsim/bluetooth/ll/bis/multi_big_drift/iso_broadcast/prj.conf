## CMakeLists.txt
```
# SPDX-License-Identifier: Apache-2.0

cmake_minimum_required(VERSION 3.28.0)

find_package(Zephyr REQUIRED HINTS $ENV{ZEPHYR_BASE})
project(bsim_test_bis_multi_big_drift_iso_broadcast)

set(sample_path ${ZEPHYR_BASE}/samples/bluetooth/iso_broadcast)

target_sources(app PRIVATE
  ${sample_path}/src/main.c
  src/test_main.c
)

target_include_directories(app PRIVATE ${sample_path}/src)

zephyr_include_directories(
  ${BSIM_COMPONENTS_PATH}/libUtilv1/src/
  ${BSIM_COMPONENTS_PATH}/libPhyComv1/src/
)
```

## Kconfig
```
# Copyright The Zephyr Project Contributors
# SPDX-License-Identifier: Apache-2.0

source "$(ZEPHYR_BASE)/samples/bluetooth/iso_broadcast/Kconfig"
```

## prj.conf
```kconfig
# Build using the sample configuration files:
# ${ZEPHYR_BASE}/samples/bluetooth/iso_broadcast/prj.conf
# ${ZEPHYR_BASE}/samples/bluetooth/iso_broadcast/overlay-bt_ll_sw_split.conf
```

## overlay-bsim.conf
```kconfig
# Keep the BIG active for the whole simulation
CONFIG_ISO_BIG_TERMINATE_TIMEOUT=0
CONFIG_ISO_PRINT_INTERVAL=100
```

## src/test_main.c
```c
/*
 * Copyright The Zephyr Project Contributors
 *
 * SPDX-License-Identifier: Apache-2.0
 */

#include <stdint.h>

#include "bsim_args_runner.h"
#include "bstests.h"

/* Use a unique advertising SID per simulated device; device 0..N-1 are broadcasters */
uint8_t iso_broadcast_sid_get(void)
{
	return (uint8_t)get_device_nbr();
}

bst_test_install_t test_installers[] = {
	NULL
};
```

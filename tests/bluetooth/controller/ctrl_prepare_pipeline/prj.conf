## CMakeLists.txt
```
# SPDX-License-Identifier: Apache-2.0

cmake_minimum_required(VERSION 3.20.0)

find_package(Zephyr COMPONENTS unittest REQUIRED HINTS $ENV{ZEPHYR_BASE})

project(bluetooth_ull_prepare_pipeline)

add_subdirectory(${ZEPHYR_BASE}/tests/bluetooth/controller/common common)

target_link_libraries(testbinary PRIVATE common)

target_sources(testbinary
  PRIVATE
    src/main.c
    src/ull_prepare_impl.c
    src/test_ull_prepare_basic.c
    src/test_ull_prepare_ordering.c
    src/test_ull_prepare_iterator.c
    src/test_ull_prepare_edge_cases.c
    ${ZEPHYR_BASE}/subsys/bluetooth/controller/util/mem.c
)

# Include paths for controller sources
target_include_directories(testbinary PRIVATE
  ${ZEPHYR_BASE}/subsys/bluetooth/controller
  ${ZEPHYR_BASE}/subsys/bluetooth/controller/ll_sw
  ${ZEPHYR_BASE}/subsys/bluetooth/controller/ll_sw/nordic
  ${ZEPHYR_BASE}/subsys/bluetooth/controller/include
  ${ZEPHYR_BASE}/subsys/bluetooth/controller/util
  ${ZEPHYR_BASE}/subsys/bluetooth
  ${ZEPHYR_BASE}/include/zephyr/bluetooth
)
```

## Kconfig
```
# Copyright (c) 2024 Nordic Semiconductor ASA
# SPDX-License-Identifier: Apache-2.0

config SOC_COMPATIBLE_NRF
	default y

config BT_CTLR_DATA_LEN_UPDATE_SUPPORT
	default y

config BT_CTLR_PHY_UPDATE_SUPPORT
	default y

config BT_CTLR_PHY_CODED_SUPPORT
	default y

config BT_CTLR_PHY_2M_SUPPORT
	default y

config ENTROPY_NRF_FORCE_ALT
	default n

config ENTROPY_NRF5_RNG
	default n

source "tests/bluetooth/controller/common/Kconfig"

# Include Zephyr's Kconfig
source "Kconfig"
```

## prj.conf
```kconfig
CONFIG_ZTEST=y

CONFIG_ASSERT=y
CONFIG_ASSERT_LEVEL=2
CONFIG_ASSERT_VERBOSE=y

CONFIG_BT=y
CONFIG_BT_HCI=y

CONFIG_BT_LLL_VENDOR_NORDIC=y

CONFIG_BT_CENTRAL=y
CONFIG_BT_PERIPHERAL=y
CONFIG_BT_BROADCASTER=y
CONFIG_BT_OBSERVER=y

CONFIG_BT_CTLR_ASSERT_HANDLER=y

CONFIG_BT_BUF_ACL_TX_SIZE=251
CONFIG_BT_BUF_ACL_RX_SIZE=251
CONFIG_BT_DATA_LEN_UPDATE=y
CONFIG_BT_CTLR_DATA_LENGTH_MAX=251

CONFIG_BT_PHY_UPDATE=y
CONFIG_BT_CTLR_PHY_2M=y
CONFIG_BT_CTLR_PHY_CODED=y
```

## src/main.c
```c
/*
 * Copyright (c) 2024 Nordic Semiconductor ASA
 *
 * SPDX-License-Identifier: Apache-2.0
 */

/**
 * @file
 * @brief Comprehensive unit tests for ULL prepare pipeline (PR #79444)
 *
 * ⚠️ IMPORTANT: These tests are written for the FUTURE implementation
 * described in PR #79444, which replaces MFIFO with an ordered linked list.
 *
 * Current implementation uses MFIFO; these tests will need adaptation
 * when PR #79444 is merged.
 *
 * This test suite validates the ordered linked list implementation that
 * replaces the FIFO-based prepare pipeline in PR #79444.
 *
 * Key changes tested:
 * - Data structure change from MFIFO to ordered linked list
 * - Iterator interface change from uint8_t* to void**
 * - Ordered insertion based on ticks_at_expire
 * - Resume events always placed at tail
 */

#include <string.h>
#include <zephyr/types.h>
#include <zephyr/ztest.h>
#include <zephyr/kernel.h>

#include "util/util.h"
#include "util/mem.h"
#include "util/memq.h"
#include "util/mayfly.h"

#include "lll.h"
#include "ull_internal.h"

/* External test suite declarations */
extern struct ztest_suite_node test_ull_prepare_basic_suite_node;
extern struct ztest_suite_node test_ull_prepare_ordering_suite_node;
extern struct ztest_suite_node test_ull_prepare_iterator_suite_node;
extern struct ztest_suite_node test_ull_prepare_edge_cases_suite_node;

void main(void)
{
	ztest_run_all(NULL, false, 1, 1);
}
```

## src/test_common.h
```c
/*
 * Copyright (c) 2024 Nordic Semiconductor ASA
 *
 * SPDX-License-Identifier: Apache-2.0
 */

#ifndef ZEPHYR_TESTS_BT_CTRL_PREPARE_PIPELINE_H_
#define ZEPHYR_TESTS_BT_CTRL_PREPARE_PIPELINE_H_

/**
 * @brief Initialize the prepare pipeline for testing
 *
 * Must be called before any prepare pipeline operations.
 */
void ull_prepare_pipeline_init(void);

/**
 * @brief Cleanup the prepare pipeline after testing
 *
 * Frees all allocated events and resets the pipeline.
 */
void ull_prepare_pipeline_cleanup(void);

#endif /* ZEPHYR_TESTS_BT_CTRL_PREPARE_PIPELINE_H_ */
```

## src/test_ull_prepare_basic.c
```c
/*
 * Copyright (c) 2024 Nordic Semiconductor ASA
 *
 * SPDX-License-Identifier: Apache-2.0
 */

/**
 * @file
 * @brief Basic prepare pipeline operations tests
 *
 * Tests basic enqueue/dequeue operations for the ordered linked list
 * implementation introduced in PR #79444.
 */

#include <string.h>
#include <zephyr/types.h>
#include <zephyr/ztest.h>

#include "util/util.h"
#include "util/mem.h"
#include "util/memq.h"

#include "lll.h"
#include "ull_internal.h"

#include "test_common.h"

/* Mock callbacks for testing */
static int test_prepare_cb(struct lll_prepare_param *prepare_param)
{
	return 0;
}

static int test_is_abort_cb(void *next, void *curr, lll_prepare_cb_t *resume_cb)
{
	return 0;
}

static void test_abort_cb(struct lll_prepare_param *prepare_param, void *param)
{
	/* No-op for testing */
}

/*
 * Test: Enqueue to empty pipeline
 * Validates that a single event can be enqueued successfully to an empty pipeline.
 */
ZTEST(test_ull_prepare_basic, test_enqueue_empty_pipeline)
{
	struct lll_prepare_param prepare_param;
	struct lll_event *event;

	memset(&prepare_param, 0, sizeof(prepare_param));
	prepare_param.ticks_at_expire = 1000;
	prepare_param.param = (void *)0x1234;

	/* Enqueue event to empty pipeline */
	event = ull_prepare_enqueue(test_is_abort_cb, test_abort_cb,
				    &prepare_param, test_prepare_cb, 0);

	zassert_not_null(event, "Failed to enqueue event to empty pipeline");
	zassert_equal(event->prepare_param.ticks_at_expire, 1000,
		     "Event ticks_at_expire mismatch");
	zassert_equal(event->prepare_param.param, (void *)0x1234,
		     "Event param mismatch");
	zassert_equal(event->is_resume, 0, "Event should not be marked as resume");
	zassert_equal(event->is_aborted, 0, "Event should not be marked as aborted");
}

/*
 * Test: Enqueue multiple events
 * Validates that multiple events can be enqueued successfully.
 */
ZTEST(test_ull_prepare_basic, test_enqueue_multiple_events)
{
	struct lll_prepare_param prepare_params[5];
	struct lll_event *events[5];
	int i;

	/* Enqueue 5 events with different tick values */
	for (i = 0; i < 5; i++) {
		memset(&prepare_params[i], 0, sizeof(prepare_params[i]));
		prepare_params[i].ticks_at_expire = 1000 + (i * 100);
		prepare_params[i].param = (void *)(uintptr_t)(0x1000 + i);

		events[i] = ull_prepare_enqueue(test_is_abort_cb, test_abort_cb,
						&prepare_params[i], test_prepare_cb, 0);

		zassert_not_null(events[i], "Failed to enqueue event %d", i);
		zassert_equal(events[i]->prepare_param.ticks_at_expire,
			     1000 + (i * 100),
			     "Event %d ticks_at_expire mismatch", i);
	}
}

/*
 * Test: Dequeue from pipeline
 * Validates that dequeue_get() retrieves the head event without removal.
 */
ZTEST(test_ull_prepare_basic, test_dequeue_get)
{
	struct lll_prepare_param prepare_param;
	struct lll_event *event, *head;

	memset(&prepare_param, 0, sizeof(prepare_param));
	prepare_param.ticks_at_expire = 2000;
	prepare_param.param = (void *)0x5678;

	/* Enqueue an event */
	event = ull_prepare_enqueue(test_is_abort_cb, test_abort_cb,
				    &prepare_param, test_prepare_cb, 0);
	zassert_not_null(event, "Failed to enqueue event");

	/* Get head without removing */
	head = ull_prepare_dequeue_get();
	zassert_not_null(head, "Failed to get head of pipeline");
	zassert_equal(head, event, "Head should be the enqueued event");
	
	/* Verify head still accessible (not removed) */
	head = ull_prepare_dequeue_get();
	zassert_equal(head, event, "Head should still be accessible");
}

/*
 * Test: Dequeue from empty pipeline
 * Validates that dequeue_get() returns NULL for empty pipeline.
 */
ZTEST(test_ull_prepare_basic, test_dequeue_empty_pipeline)
{
	struct lll_event *head;

	/* Try to get head from empty pipeline */
	head = ull_prepare_dequeue_get();
	zassert_is_null(head, "Empty pipeline should return NULL");
}

/*
 * Test: Resume event marking
 * Validates that resume events are properly marked.
 */
ZTEST(test_ull_prepare_basic, test_resume_event_marking)
{
	struct lll_prepare_param prepare_param;
	struct lll_event *event;

	memset(&prepare_param, 0, sizeof(prepare_param));
	prepare_param.ticks_at_expire = 3000;

	/* Enqueue as resume event */
	event = ull_prepare_enqueue(test_is_abort_cb, test_abort_cb,
				    &prepare_param, test_prepare_cb, 1);

	zassert_not_null(event, "Failed to enqueue resume event");
	zassert_equal(event->is_resume, 1, "Event should be marked as resume");
	zassert_equal(event->is_aborted, 0, "Event should not be aborted");
}

/*
 * Test: Aborted event marking
 * Validates that events can be marked as aborted.
 */
ZTEST(test_ull_prepare_basic, test_aborted_event_marking)
{
	struct lll_prepare_param prepare_param;
	struct lll_event *event;

	memset(&prepare_param, 0, sizeof(prepare_param));
	prepare_param.ticks_at_expire = 4000;

	/* Enqueue event */
	event = ull_prepare_enqueue(test_is_abort_cb, test_abort_cb,
				    &prepare_param, test_prepare_cb, 0);
	zassert_not_null(event, "Failed to enqueue event");

	/* Mark as aborted */
	event->is_aborted = 1;

	zassert_equal(event->is_aborted, 1, "Event should be marked as aborted");
}

/*
 * Test: Callback assignments
 * Validates that all callbacks are properly assigned.
 */
ZTEST(test_ull_prepare_basic, test_callback_assignments)
{
	struct lll_prepare_param prepare_param;
	struct lll_event *event;

	memset(&prepare_param, 0, sizeof(prepare_param));
	prepare_param.ticks_at_expire = 5000;

	/* Enqueue event with callbacks */
	event = ull_prepare_enqueue(test_is_abort_cb, test_abort_cb,
				    &prepare_param, test_prepare_cb, 0);

	zassert_not_null(event, "Failed to enqueue event");
	zassert_equal(event->prepare_cb, test_prepare_cb,
		     "Prepare callback not assigned correctly");
	zassert_equal(event->is_abort_cb, test_is_abort_cb,
		     "Is-abort callback not assigned correctly");
	zassert_equal(event->abort_cb, test_abort_cb,
		     "Abort callback not assigned correctly");
}

/* Test suite setup and teardown */
static void *test_ull_prepare_basic_setup(void)
{
	return NULL;
}

static void test_ull_prepare_basic_before(void *f)
{
	/* Initialize pipeline before each test */
	ull_prepare_pipeline_init();
}

static void test_ull_prepare_basic_after(void *f)
{
	/* Cleanup pipeline after each test to ensure clean state */
	ull_prepare_pipeline_cleanup();
}

static void test_ull_prepare_basic_teardown(void *f)
{
	/* Final cleanup */
}

ZTEST_SUITE(test_ull_prepare_basic, NULL,
	   test_ull_prepare_basic_setup,
	   test_ull_prepare_basic_before,
	   test_ull_prepare_basic_after,
	   test_ull_prepare_basic_teardown);
```

## src/test_ull_prepare_edge_cases.c
```c
/*
 * Copyright (c) 2024 Nordic Semiconductor ASA
 *
 * SPDX-License-Identifier: Apache-2.0
 */

/**
 * @file
 * @brief Prepare pipeline edge case and boundary condition tests
 *
 * Tests edge cases, boundary conditions, and error handling for the
 * ordered linked list implementation in PR #79444.
 */

#include <string.h>
#include <zephyr/types.h>
#include <zephyr/ztest.h>

#include "util/util.h"
#include "util/mem.h"
#include "util/memq.h"

#include "lll.h"
#include "ull_internal.h"

#include "test_common.h"

/* Event pipeline maximum size as defined in ull.c */
#define EVENT_DEFER_MAX 2
#define EVENT_PIPELINE_MAX (7U + (EVENT_DEFER_MAX))

/* Mock callbacks */
static int test_prepare_cb(struct lll_prepare_param *prepare_param)
{
	return 0;
}

static int test_is_abort_cb(void *next, void *curr, lll_prepare_cb_t *resume_cb)
{
	return 0;
}

static void test_abort_cb(struct lll_prepare_param *prepare_param, void *param)
{
}

/*
 * Test: Empty pipeline operations
 * Validates behavior on empty pipeline for all operations.
 */
ZTEST(test_ull_prepare_edge_cases, test_empty_pipeline_operations)
{
	struct lll_event *event;
	void *idx = NULL;

	/* dequeue_get on empty pipeline */
	event = ull_prepare_dequeue_get();
	zassert_is_null(event, "dequeue_get should return NULL on empty pipeline");

	/* dequeue_iter on empty pipeline */
	event = ull_prepare_dequeue_iter(&idx);
	zassert_is_null(event, "dequeue_iter should return NULL on empty pipeline");
}

/*
 * Test: Single element pipeline operations
 * Edge case testing with only one element in pipeline.
 */
ZTEST(test_ull_prepare_edge_cases, test_single_element_pipeline)
{
	struct lll_prepare_param prepare_param;
	struct lll_event *event, *retrieved;
	void *idx = NULL;

	/* Enqueue single event */
	memset(&prepare_param, 0, sizeof(prepare_param));
	prepare_param.ticks_at_expire = 1000;
	prepare_param.param = (void *)0xABCD;

	event = ull_prepare_enqueue(test_is_abort_cb, test_abort_cb,
				    &prepare_param, test_prepare_cb, 0);
	zassert_not_null(event, "Failed to enqueue single event");

	/* Get head */
	retrieved = ull_prepare_dequeue_get();
	zassert_equal(retrieved, event, "Head should be the single event");

	/* Iterate */
	retrieved = ull_prepare_dequeue_iter(&idx);
	zassert_equal(retrieved, event, "Iterator should return single event");

	/* Next iteration should be NULL */
	retrieved = ull_prepare_dequeue_iter(&idx);
	zassert_is_null(retrieved, "Iterator should return NULL after single event");
}

/*
 * Test: Pipeline full condition
 * Tests behavior when pipeline reaches maximum capacity.
 * Note: This test validates that enqueue handles full pipeline gracefully.
 */
ZTEST(test_ull_prepare_edge_cases, test_pipeline_full_condition)
{
	struct lll_prepare_param prepare_params[EVENT_PIPELINE_MAX + 1];
	struct lll_event *events[EVENT_PIPELINE_MAX + 1];
	int i;
	int success_count = 0;

	/* Try to enqueue more than pipeline max */
	for (i = 0; i < EVENT_PIPELINE_MAX + 1; i++) {
		memset(&prepare_params[i], 0, sizeof(prepare_params[i]));
		prepare_params[i].ticks_at_expire = 1000 + (i * 100);
		prepare_params[i].param = (void *)(uintptr_t)i;

		events[i] = ull_prepare_enqueue(test_is_abort_cb, test_abort_cb,
						&prepare_params[i], test_prepare_cb, 0);
		if (events[i] != NULL) {
			success_count++;
		}
	}

	/* At least EVENT_PIPELINE_MAX events should be enqueued successfully */
	zassert_true(success_count >= EVENT_PIPELINE_MAX,
		    "Should enqueue at least EVENT_PIPELINE_MAX events");

	/* If pipeline is full, last enqueue might fail */
	if (success_count == EVENT_PIPELINE_MAX) {
		zassert_is_null(events[EVENT_PIPELINE_MAX],
			       "Enqueue should fail when pipeline is full");
	}
}

/*
 * Test: Tick counter wraparound scenarios
 * Tests ordering behavior when tick values wrap around 32-bit boundary.
 */
ZTEST(test_ull_prepare_edge_cases, test_tick_wraparound)
{
	struct lll_prepare_param prepare_params[4];
	struct lll_event *events[4];
	void *idx = NULL;
	struct lll_event *current;
	int i;

	/* Create events near wraparound boundary */
	/* Event 1: Near max uint32_t */
	memset(&prepare_params[0], 0, sizeof(prepare_params[0]));
	prepare_params[0].ticks_at_expire = UINT32_MAX - 1000;
	events[0] = ull_prepare_enqueue(test_is_abort_cb, test_abort_cb,
					&prepare_params[0], test_prepare_cb, 0);

	/* Event 2: Very close to max */
	memset(&prepare_params[1], 0, sizeof(prepare_params[1]));
	prepare_params[1].ticks_at_expire = UINT32_MAX - 100;
	events[1] = ull_prepare_enqueue(test_is_abort_cb, test_abort_cb,
					&prepare_params[1], test_prepare_cb, 0);

	/* Event 3: After wraparound (small value) */
	memset(&prepare_params[2], 0, sizeof(prepare_params[2]));
	prepare_params[2].ticks_at_expire = 100;
	events[2] = ull_prepare_enqueue(test_is_abort_cb, test_abort_cb,
					&prepare_params[2], test_prepare_cb, 0);

	/* Event 4: Another after wraparound */
	memset(&prepare_params[3], 0, sizeof(prepare_params[3]));
	prepare_params[3].ticks_at_expire = 500;
	events[3] = ull_prepare_enqueue(test_is_abort_cb, test_abort_cb,
					&prepare_params[3], test_prepare_cb, 0);

	/* All events should be enqueued */
	for (i = 0; i < 4; i++) {
		zassert_not_null(events[i], "Event %d should be enqueued", i);
	}

	/* Verify we can iterate through all events */
	i = 0;
	while ((current = ull_prepare_dequeue_iter(&idx)) != NULL) {
		i++;
	}
	zassert_equal(i, 4, "Should iterate through all 4 events");
}

/*
 * Test: Multiple dequeue_get calls
 * Validates that dequeue_get doesn't modify pipeline state.
 */
ZTEST(test_ull_prepare_edge_cases, test_multiple_dequeue_get_calls)
{
	struct lll_prepare_param prepare_param;
	struct lll_event *event, *head1, *head2, *head3;

	/* Enqueue event */
	memset(&prepare_param, 0, sizeof(prepare_param));
	prepare_param.ticks_at_expire = 1000;

	event = ull_prepare_enqueue(test_is_abort_cb, test_abort_cb,
				    &prepare_param, test_prepare_cb, 0);
	zassert_not_null(event, "Failed to enqueue event");

	/* Multiple dequeue_get calls should return same event */
	head1 = ull_prepare_dequeue_get();
	head2 = ull_prepare_dequeue_get();
	head3 = ull_prepare_dequeue_get();

	zassert_equal(head1, head2, "Multiple dequeue_get should return same head");
	zassert_equal(head2, head3, "Multiple dequeue_get should return same head");
	zassert_equal(head1, event, "Head should be the enqueued event");
}

/*
 * Test: Alternating enqueue and iterate
 * Tests pipeline behavior with interleaved operations.
 */
ZTEST(test_ull_prepare_edge_cases, test_alternating_enqueue_iterate)
{
	struct lll_prepare_param prepare_params[6];
	struct lll_event *events[6];
	void *idx = NULL;
	struct lll_event *current;
	int i, count;

	/* Enqueue 3 events */
	for (i = 0; i < 3; i++) {
		memset(&prepare_params[i], 0, sizeof(prepare_params[i]));
		prepare_params[i].ticks_at_expire = 1000 + (i * 100);
		events[i] = ull_prepare_enqueue(test_is_abort_cb, test_abort_cb,
						&prepare_params[i], test_prepare_cb, 0);
	}

	/* Iterate to first event */
	current = ull_prepare_dequeue_iter(&idx);
	zassert_not_null(current, "First event should exist");

	/* Enqueue more events */
	for (i = 3; i < 6; i++) {
		memset(&prepare_params[i], 0, sizeof(prepare_params[i]));
		prepare_params[i].ticks_at_expire = 1000 + (i * 100);
		events[i] = ull_prepare_enqueue(test_is_abort_cb, test_abort_cb,
						&prepare_params[i], test_prepare_cb, 0);
	}

	/* Complete iteration - may see newly added events depending on implementation */
	count = 1; /* Already got first event */
	while ((current = ull_prepare_dequeue_iter(&idx)) != NULL) {
		count++;
		if (count > 10) { /* Safety limit */
			break;
		}
	}

	zassert_true(count >= 3, "Should see at least initial 3 events");
}

/*
 * Test: Same tick values
 * Tests ordering when multiple events have identical ticks_at_expire.
 */
ZTEST(test_ull_prepare_edge_cases, test_same_tick_values)
{
	struct lll_prepare_param prepare_params[4];
	struct lll_event *events[4];
	void *idx = NULL;
	struct lll_event *current;
	int i, count;

	/* Enqueue events with same tick value */
	for (i = 0; i < 4; i++) {
		memset(&prepare_params[i], 0, sizeof(prepare_params[i]));
		prepare_params[i].ticks_at_expire = 5000; /* All same */
		prepare_params[i].param = (void *)(uintptr_t)i;

		events[i] = ull_prepare_enqueue(test_is_abort_cb, test_abort_cb,
						&prepare_params[i], test_prepare_cb, 0);
		zassert_not_null(events[i], "Failed to enqueue event %d", i);
	}

	/* Verify all events are in pipeline */
	count = 0;
	while ((current = ull_prepare_dequeue_iter(&idx)) != NULL) {
		zassert_equal(current->prepare_param.ticks_at_expire, 5000,
			     "All events should have same tick value");
		count++;
	}

	zassert_equal(count, 4, "All 4 events should be in pipeline");
}

/*
 * Test: Zero tick values
 * Edge case with tick value of 0.
 */
ZTEST(test_ull_prepare_edge_cases, test_zero_tick_values)
{
	struct lll_prepare_param prepare_params[3];
	struct lll_event *events[3];
	void *idx = NULL;
	struct lll_event *current;
	uint32_t prev_ticks;
	int i;

	/* Event with tick 0 */
	memset(&prepare_params[0], 0, sizeof(prepare_params[0]));
	prepare_params[0].ticks_at_expire = 0;
	events[0] = ull_prepare_enqueue(test_is_abort_cb, test_abort_cb,
					&prepare_params[0], test_prepare_cb, 0);

	/* Event with tick 100 */
	memset(&prepare_params[1], 0, sizeof(prepare_params[1]));
	prepare_params[1].ticks_at_expire = 100;
	events[1] = ull_prepare_enqueue(test_is_abort_cb, test_abort_cb,
					&prepare_params[1], test_prepare_cb, 0);

	/* Another event with tick 0 */
	memset(&prepare_params[2], 0, sizeof(prepare_params[2]));
	prepare_params[2].ticks_at_expire = 0;
	events[2] = ull_prepare_enqueue(test_is_abort_cb, test_abort_cb,
					&prepare_params[2], test_prepare_cb, 0);

	/* Verify ordering */
	i = 0;
	prev_ticks = 0;
	while ((current = ull_prepare_dequeue_iter(&idx)) != NULL) {
		if (i > 0) {
			zassert_true(current->prepare_param.ticks_at_expire >= prev_ticks,
				    "Events should be in ascending order");
		}
		prev_ticks = current->prepare_param.ticks_at_expire;
		i++;
	}

	zassert_equal(i, 3, "Should have 3 events");
}

/*
 * Test: Max tick value
 * Edge case with maximum uint32_t tick value.
 */
ZTEST(test_ull_prepare_edge_cases, test_max_tick_value)
{
	struct lll_prepare_param prepare_params[2];
	struct lll_event *events[2];
	void *idx = NULL;
	struct lll_event *current;

	/* Event with max tick */
	memset(&prepare_params[0], 0, sizeof(prepare_params[0]));
	prepare_params[0].ticks_at_expire = UINT32_MAX;
	events[0] = ull_prepare_enqueue(test_is_abort_cb, test_abort_cb,
					&prepare_params[0], test_prepare_cb, 0);
	zassert_not_null(events[0], "Should enqueue event with max tick");

	/* Event with max - 1 tick */
	memset(&prepare_params[1], 0, sizeof(prepare_params[1]));
	prepare_params[1].ticks_at_expire = UINT32_MAX - 1;
	events[1] = ull_prepare_enqueue(test_is_abort_cb, test_abort_cb,
					&prepare_params[1], test_prepare_cb, 0);
	zassert_not_null(events[1], "Should enqueue event with max-1 tick");

	/* Verify both events are accessible */
	current = ull_prepare_dequeue_iter(&idx);
	zassert_not_null(current, "First event should be accessible");

	current = ull_prepare_dequeue_iter(&idx);
	zassert_not_null(current, "Second event should be accessible");
}

/* Test suite setup/teardown */
static void *test_ull_prepare_edge_cases_setup(void)
{
	return NULL;
}

static void test_ull_prepare_edge_cases_before(void *f)
{
	ull_prepare_pipeline_init();
}

static void test_ull_prepare_edge_cases_after(void *f)
{
	ull_prepare_pipeline_cleanup();
}

static void test_ull_prepare_edge_cases_teardown(void *f)
{
}

ZTEST_SUITE(test_ull_prepare_edge_cases, NULL,
	   test_ull_prepare_edge_cases_setup,
	   test_ull_prepare_edge_cases_before,
	   test_ull_prepare_edge_cases_after,
	   test_ull_prepare_edge_cases_teardown);
```

## src/test_ull_prepare_iterator.c
```c
/*
 * Copyright (c) 2024 Nordic Semiconductor ASA
 *
 * SPDX-License-Identifier: Apache-2.0
 */

/**
 * @file
 * @brief Prepare pipeline iterator tests
 *
 * Tests the iterator functionality with the new void** interface
 * introduced in PR #79444 (changed from uint8_t*).
 */

#include <string.h>
#include <zephyr/types.h>
#include <zephyr/ztest.h>

#include "util/util.h"
#include "util/mem.h"
#include "util/memq.h"

#include "lll.h"
#include "ull_internal.h"

#include "test_common.h"

/* Mock callbacks */
static int test_prepare_cb(struct lll_prepare_param *prepare_param)
{
	return 0;
}

static int test_is_abort_cb(void *next, void *curr, lll_prepare_cb_t *resume_cb)
{
	return 0;
}

static void test_abort_cb(struct lll_prepare_param *prepare_param, void *param)
{
}

/*
 * Test: Iterator initialization with NULL
 * PR #79444: idx = NULL should initialize iterator to head of list.
 */
ZTEST(test_ull_prepare_iterator, test_iterator_init_null)
{
	struct lll_prepare_param prepare_param;
	struct lll_event *event, *first;
	void *idx = NULL;

	/* Enqueue one event */
	memset(&prepare_param, 0, sizeof(prepare_param));
	prepare_param.ticks_at_expire = 1000;
	prepare_param.param = (void *)0x1111;

	event = ull_prepare_enqueue(test_is_abort_cb, test_abort_cb,
				    &prepare_param, test_prepare_cb, 0);
	zassert_not_null(event, "Failed to enqueue event");

	/* Initialize iterator with NULL */
	first = ull_prepare_dequeue_iter(&idx);
	zassert_not_null(first, "Iterator should return first event");
	zassert_equal(first, event, "First event should match enqueued event");
}

/*
 * Test: Complete iteration through list
 * Validates that iterator traverses all events in the list.
 */
ZTEST(test_ull_prepare_iterator, test_complete_iteration)
{
	struct lll_prepare_param prepare_params[5];
	struct lll_event *events[5];
	void *idx = NULL;
	struct lll_event *current;
	int count = 0;
	int i;

	/* Enqueue 5 events */
	for (i = 0; i < 5; i++) {
		memset(&prepare_params[i], 0, sizeof(prepare_params[i]));
		prepare_params[i].ticks_at_expire = 1000 + (i * 100);
		prepare_params[i].param = (void *)(uintptr_t)i;

		events[i] = ull_prepare_enqueue(test_is_abort_cb, test_abort_cb,
						&prepare_params[i], test_prepare_cb, 0);
		zassert_not_null(events[i], "Failed to enqueue event %d", i);
	}

	/* Iterate through all events */
	while ((current = ull_prepare_dequeue_iter(&idx)) != NULL) {
		zassert_not_null(current, "Current event should not be NULL");
		count++;
	}

	zassert_equal(count, 5, "Should iterate through all 5 events");
}

/*
 * Test: Iterator termination condition
 * PR #79444: Iterator returns NULL when idx becomes NULL (end of list).
 */
ZTEST(test_ull_prepare_iterator, test_iterator_termination)
{
	struct lll_prepare_param prepare_params[3];
	struct lll_event *events[3];
	void *idx = NULL;
	struct lll_event *current;
	int i;

	/* Enqueue 3 events */
	for (i = 0; i < 3; i++) {
		memset(&prepare_params[i], 0, sizeof(prepare_params[i]));
		prepare_params[i].ticks_at_expire = 1000 + (i * 200);

		events[i] = ull_prepare_enqueue(test_is_abort_cb, test_abort_cb,
						&prepare_params[i], test_prepare_cb, 0);
	}

	/* Iterate through all events */
	for (i = 0; i < 3; i++) {
		current = ull_prepare_dequeue_iter(&idx);
		zassert_not_null(current, "Event %d should not be NULL", i);
	}

	/* Next call should return NULL (end of list) */
	current = ull_prepare_dequeue_iter(&idx);
	zassert_is_null(current, "Iterator should return NULL at end of list");

	/* Subsequent calls should also return NULL */
	current = ull_prepare_dequeue_iter(&idx);
	zassert_is_null(current, "Iterator should remain NULL");
}

/*
 * Test: Iterator on empty pipeline
 * Validates iterator behavior on empty pipeline.
 */
ZTEST(test_ull_prepare_iterator, test_iterator_empty_pipeline)
{
	void *idx = NULL;
	struct lll_event *current;

	/* Try to iterate on empty pipeline */
	current = ull_prepare_dequeue_iter(&idx);
	zassert_is_null(current, "Iterator on empty pipeline should return NULL");
}

/*
 * Test: Iterator with single event
 * Edge case: pipeline with only one event.
 */
ZTEST(test_ull_prepare_iterator, test_iterator_single_event)
{
	struct lll_prepare_param prepare_param;
	struct lll_event *event, *current;
	void *idx = NULL;

	/* Enqueue single event */
	memset(&prepare_param, 0, sizeof(prepare_param));
	prepare_param.ticks_at_expire = 1000;

	event = ull_prepare_enqueue(test_is_abort_cb, test_abort_cb,
				    &prepare_param, test_prepare_cb, 0);
	zassert_not_null(event, "Failed to enqueue event");

	/* First iteration should return the event */
	current = ull_prepare_dequeue_iter(&idx);
	zassert_equal(current, event, "Should return the single event");

	/* Second iteration should return NULL */
	current = ull_prepare_dequeue_iter(&idx);
	zassert_is_null(current, "Should return NULL after single event");
}

/*
 * Test: Iterator with mixed event types
 * Tests iteration through normal, resume, and aborted events.
 */
ZTEST(test_ull_prepare_iterator, test_iterator_mixed_event_types)
{
	struct lll_prepare_param prepare_params[6];
	struct lll_event *events[6];
	void *idx = NULL;
	struct lll_event *current;
	int count = 0;
	int normal_count = 0;
	int resume_count = 0;
	int aborted_count = 0;
	int i;

	/* Enqueue mix of event types */
	for (i = 0; i < 6; i++) {
		memset(&prepare_params[i], 0, sizeof(prepare_params[i]));
		prepare_params[i].ticks_at_expire = 1000 + (i * 100);

		/* Alternating: normal, resume, normal, resume, normal, resume */
		uint8_t is_resume = (i % 2);
		events[i] = ull_prepare_enqueue(test_is_abort_cb, test_abort_cb,
						&prepare_params[i], test_prepare_cb,
						is_resume);
	}

	/* Mark some as aborted */
	events[1]->is_aborted = 1;
	events[4]->is_aborted = 1;

	/* Iterate and count event types */
	while ((current = ull_prepare_dequeue_iter(&idx)) != NULL) {
		count++;
		if (current->is_aborted) {
			aborted_count++;
		} else if (current->is_resume) {
			resume_count++;
		} else {
			normal_count++;
		}
	}

	zassert_equal(count, 6, "Should iterate through all 6 events");
	zassert_equal(aborted_count, 2, "Should find 2 aborted events");
	/* Note: resume_count includes aborted resume events */
}

/*
 * Test: Iterator break condition safety
 * PR #79444: Breaking when !idx should be safe.
 */
ZTEST(test_ull_prepare_iterator, test_iterator_break_condition)
{
	struct lll_prepare_param prepare_params[5];
	struct lll_event *events[5];
	void *idx = NULL;
	struct lll_event *current;
	int count = 0;
	int i;

	/* Enqueue 5 events */
	for (i = 0; i < 5; i++) {
		memset(&prepare_params[i], 0, sizeof(prepare_params[i]));
		prepare_params[i].ticks_at_expire = 1000 + (i * 100);

		events[i] = ull_prepare_enqueue(test_is_abort_cb, test_abort_cb,
						&prepare_params[i], test_prepare_cb, 0);
	}

	/* Iterate with early break on condition */
	while ((current = ull_prepare_dequeue_iter(&idx)) != NULL) {
		count++;
		/* Break after 3 events */
		if (count >= 3) {
			break;
		}
	}

	zassert_equal(count, 3, "Should have broken after 3 events");

	/* Verify we can restart iteration */
	idx = NULL;
	count = 0;
	while ((current = ull_prepare_dequeue_iter(&idx)) != NULL) {
		count++;
	}

	zassert_equal(count, 5, "Restarted iteration should see all events");
}

/*
 * Test: Iterator parameter passing
 * Validates that idx is properly updated during iteration.
 */
ZTEST(test_ull_prepare_iterator, test_iterator_parameter_update)
{
	struct lll_prepare_param prepare_params[3];
	struct lll_event *events[3];
	void *idx = NULL;
	void *prev_idx;
	struct lll_event *current;
	int i;

	/* Enqueue 3 events */
	for (i = 0; i < 3; i++) {
		memset(&prepare_params[i], 0, sizeof(prepare_params[i]));
		prepare_params[i].ticks_at_expire = 1000 + (i * 100);

		events[i] = ull_prepare_enqueue(test_is_abort_cb, test_abort_cb,
						&prepare_params[i], test_prepare_cb, 0);
	}

	/* Verify idx is updated during iteration */
	prev_idx = idx;
	current = ull_prepare_dequeue_iter(&idx);
	zassert_not_null(current, "First event should not be NULL");
	zassert_not_equal(idx, prev_idx, "idx should be updated after first call");

	prev_idx = idx;
	current = ull_prepare_dequeue_iter(&idx);
	zassert_not_null(current, "Second event should not be NULL");
	/* idx may or may not change depending on implementation */

	current = ull_prepare_dequeue_iter(&idx);
	zassert_not_null(current, "Third event should not be NULL");

	/* End of list */
	current = ull_prepare_dequeue_iter(&idx);
	zassert_is_null(current, "Should reach end of list");
}

/* Test suite setup/teardown */
static void *test_ull_prepare_iterator_setup(void)
{
	return NULL;
}

static void test_ull_prepare_iterator_before(void *f)
{
	ull_prepare_pipeline_init();
}

static void test_ull_prepare_iterator_after(void *f)
{
	ull_prepare_pipeline_cleanup();
}

static void test_ull_prepare_iterator_teardown(void *f)
{
}

ZTEST_SUITE(test_ull_prepare_iterator, NULL,
	   test_ull_prepare_iterator_setup,
	   test_ull_prepare_iterator_before,
	   test_ull_prepare_iterator_after,
	   test_ull_prepare_iterator_teardown);
```

## src/test_ull_prepare_ordering.c
```c
/*
 * Copyright (c) 2024 Nordic Semiconductor ASA
 *
 * SPDX-License-Identifier: Apache-2.0
 */

/**
 * @file
 * @brief Prepare pipeline ordering tests
 *
 * Tests the ordered insertion behavior based on ticks_at_expire,
 * which is a key feature of PR #79444's linked list implementation.
 */

#include <string.h>
#include <zephyr/types.h>
#include <zephyr/ztest.h>

#include "util/util.h"
#include "util/mem.h"
#include "util/memq.h"

#include "lll.h"
#include "ull_internal.h"

#include "test_common.h"

/* Mock callbacks */
static int test_prepare_cb(struct lll_prepare_param *prepare_param)
{
	return 0;
}

static int test_is_abort_cb(void *next, void *curr, lll_prepare_cb_t *resume_cb)
{
	return 0;
}

static void test_abort_cb(struct lll_prepare_param *prepare_param, void *param)
{
}

/*
 * Test: Events inserted in ascending time order
 * Validates that events enqueued in ascending order maintain that order.
 * With PR #79444, events should be ordered by ticks_at_expire.
 */
ZTEST(test_ull_prepare_ordering, test_ascending_order_insertion)
{
	struct lll_prepare_param prepare_params[4];
	struct lll_event *events[4];
	void *idx = NULL;
	struct lll_event *current;
	uint32_t prev_ticks = 0;
	int i;

	/* Enqueue events in ascending time order */
	for (i = 0; i < 4; i++) {
		memset(&prepare_params[i], 0, sizeof(prepare_params[i]));
		prepare_params[i].ticks_at_expire = 1000 + (i * 500);
		prepare_params[i].param = (void *)(uintptr_t)i;

		events[i] = ull_prepare_enqueue(test_is_abort_cb, test_abort_cb,
						&prepare_params[i], test_prepare_cb, 0);
		zassert_not_null(events[i], "Failed to enqueue event %d", i);
	}

	/* Iterate through pipeline and verify ascending order */
	i = 0;
	while ((current = ull_prepare_dequeue_iter(&idx)) != NULL) {
		if (i > 0) {
			zassert_true(current->prepare_param.ticks_at_expire >= prev_ticks,
				    "Events not in ascending order at position %d", i);
		}
		prev_ticks = current->prepare_param.ticks_at_expire;
		i++;
	}

	zassert_equal(i, 4, "Expected 4 events in pipeline");
}

/*
 * Test: Events inserted in descending time order
 * Validates that events enqueued in descending order are reordered
 * to ascending order by the ordered list implementation.
 */
ZTEST(test_ull_prepare_ordering, test_descending_order_insertion)
{
	struct lll_prepare_param prepare_params[4];
	struct lll_event *events[4];
	void *idx = NULL;
	struct lll_event *current;
	uint32_t prev_ticks = 0;
	int i;

	/* Enqueue events in descending time order */
	for (i = 0; i < 4; i++) {
		memset(&prepare_params[i], 0, sizeof(prepare_params[i]));
		/* Descending: 3500, 3000, 2500, 2000 */
		prepare_params[i].ticks_at_expire = 3500 - (i * 500);
		prepare_params[i].param = (void *)(uintptr_t)i;

		events[i] = ull_prepare_enqueue(test_is_abort_cb, test_abort_cb,
						&prepare_params[i], test_prepare_cb, 0);
		zassert_not_null(events[i], "Failed to enqueue event %d", i);
	}

	/* Iterate and verify they are in ascending order (reordered) */
	i = 0;
	while ((current = ull_prepare_dequeue_iter(&idx)) != NULL) {
		if (i > 0) {
			zassert_true(current->prepare_param.ticks_at_expire >= prev_ticks,
				    "Events not properly reordered at position %d", i);
		}
		prev_ticks = current->prepare_param.ticks_at_expire;
		i++;
	}

	zassert_equal(i, 4, "Expected 4 events in pipeline");
}

/*
 * Test: Events inserted in mixed time order
 * Validates ordering with randomly ordered insertion times.
 */
ZTEST(test_ull_prepare_ordering, test_mixed_order_insertion)
{
	struct lll_prepare_param prepare_params[5];
	struct lll_event *events[5];
	void *idx = NULL;
	struct lll_event *current;
	uint32_t prev_ticks = 0;
	uint32_t tick_values[] = {5000, 2000, 8000, 3000, 6000};
	int i;

	/* Enqueue events in mixed order */
	for (i = 0; i < 5; i++) {
		memset(&prepare_params[i], 0, sizeof(prepare_params[i]));
		prepare_params[i].ticks_at_expire = tick_values[i];
		prepare_params[i].param = (void *)(uintptr_t)i;

		events[i] = ull_prepare_enqueue(test_is_abort_cb, test_abort_cb,
						&prepare_params[i], test_prepare_cb, 0);
		zassert_not_null(events[i], "Failed to enqueue event %d", i);
	}

	/* Verify ascending order: should be 2000, 3000, 5000, 6000, 8000 */
	i = 0;
	while ((current = ull_prepare_dequeue_iter(&idx)) != NULL) {
		if (i > 0) {
			zassert_true(current->prepare_param.ticks_at_expire >= prev_ticks,
				    "Events not in ascending order at position %d", i);
		}
		prev_ticks = current->prepare_param.ticks_at_expire;
		i++;
	}

	zassert_equal(i, 5, "Expected 5 events in pipeline");
}

/*
 * Test: Resume events always placed at tail
 * Critical test for PR #79444: Resume events should go to tail regardless
 * of their ticks_at_expire value.
 */
ZTEST(test_ull_prepare_ordering, test_resume_events_at_tail)
{
	struct lll_prepare_param prepare_params[6];
	struct lll_event *events[6];
	void *idx = NULL;
	struct lll_event *current;
	int i, count;
	int resume_count = 0;

	/* Enqueue mix of normal and resume events */
	/* Normal event at 1000 */
	memset(&prepare_params[0], 0, sizeof(prepare_params[0]));
	prepare_params[0].ticks_at_expire = 1000;
	events[0] = ull_prepare_enqueue(test_is_abort_cb, test_abort_cb,
					&prepare_params[0], test_prepare_cb, 0);

	/* Resume event at 500 (earlier time, but should go to tail) */
	memset(&prepare_params[1], 0, sizeof(prepare_params[1]));
	prepare_params[1].ticks_at_expire = 500;
	events[1] = ull_prepare_enqueue(test_is_abort_cb, test_abort_cb,
					&prepare_params[1], test_prepare_cb, 1);

	/* Normal event at 2000 */
	memset(&prepare_params[2], 0, sizeof(prepare_params[2]));
	prepare_params[2].ticks_at_expire = 2000;
	events[2] = ull_prepare_enqueue(test_is_abort_cb, test_abort_cb,
					&prepare_params[2], test_prepare_cb, 0);

	/* Resume event at 100 (earliest time, but should go to tail) */
	memset(&prepare_params[3], 0, sizeof(prepare_params[3]));
	prepare_params[3].ticks_at_expire = 100;
	events[3] = ull_prepare_enqueue(test_is_abort_cb, test_abort_cb,
					&prepare_params[3], test_prepare_cb, 1);

	/* Normal event at 1500 */
	memset(&prepare_params[4], 0, sizeof(prepare_params[4]));
	prepare_params[4].ticks_at_expire = 1500;
	events[4] = ull_prepare_enqueue(test_is_abort_cb, test_abort_cb,
					&prepare_params[4], test_prepare_cb, 0);

	/* Resume event at 3000 */
	memset(&prepare_params[5], 0, sizeof(prepare_params[5]));
	prepare_params[5].ticks_at_expire = 3000;
	events[5] = ull_prepare_enqueue(test_is_abort_cb, test_abort_cb,
					&prepare_params[5], test_prepare_cb, 1);

	/* Verify order: normal events in ascending order, then resume events */
	count = 0;
	while ((current = ull_prepare_dequeue_iter(&idx)) != NULL) {
		if (current->is_resume) {
			/* Once we hit a resume event, all following should be resume */
			resume_count++;
		} else {
			/* Normal events should come before resume events */
			zassert_equal(resume_count, 0,
				     "Normal event found after resume event at position %d",
				     count);
		}
		count++;
	}

	zassert_equal(count, 6, "Expected 6 events in pipeline");
	zassert_equal(resume_count, 3, "Expected 3 resume events");
}

/*
 * Test: Ordering with aborted events
 * Aborted events can be placed anywhere but don't affect ordering logic.
 */
ZTEST(test_ull_prepare_ordering, test_ordering_with_aborted_events)
{
	struct lll_prepare_param prepare_params[5];
	struct lll_event *events[5];
	void *idx = NULL;
	struct lll_event *current;
	uint32_t prev_non_aborted_ticks = 0;
	int i;

	/* Enqueue events */
	for (i = 0; i < 5; i++) {
		memset(&prepare_params[i], 0, sizeof(prepare_params[i]));
		prepare_params[i].ticks_at_expire = 1000 + (i * 500);
		prepare_params[i].param = (void *)(uintptr_t)i;

		events[i] = ull_prepare_enqueue(test_is_abort_cb, test_abort_cb,
						&prepare_params[i], test_prepare_cb, 0);
		zassert_not_null(events[i], "Failed to enqueue event %d", i);
	}

	/* Mark some events as aborted */
	events[1]->is_aborted = 1;
	events[3]->is_aborted = 1;

	/* Iterate and verify non-aborted events maintain ordering */
	while ((current = ull_prepare_dequeue_iter(&idx)) != NULL) {
		if (!current->is_aborted && prev_non_aborted_ticks > 0) {
			zassert_true(current->prepare_param.ticks_at_expire >= 
				    prev_non_aborted_ticks,
				    "Non-aborted events not in ascending order");
		}
		if (!current->is_aborted) {
			prev_non_aborted_ticks = current->prepare_param.ticks_at_expire;
		}
	}
}

/*
 * Test: Interleaved resume and normal events
 * Tests complex scenario with multiple resume and normal events.
 */
ZTEST(test_ull_prepare_ordering, test_interleaved_resume_and_normal)
{
	struct lll_prepare_param prepare_params[8];
	struct lll_event *events[8];
	void *idx = NULL;
	struct lll_event *current;
	int i;
	bool found_resume = false;

	/* Alternate between normal and resume events */
	for (i = 0; i < 8; i++) {
		memset(&prepare_params[i], 0, sizeof(prepare_params[i]));
		prepare_params[i].ticks_at_expire = 1000 + (i * 300);
		prepare_params[i].param = (void *)(uintptr_t)i;

		/* Odd indices are resume events */
		uint8_t is_resume = (i % 2);
		events[i] = ull_prepare_enqueue(test_is_abort_cb, test_abort_cb,
						&prepare_params[i], test_prepare_cb,
						is_resume);
		zassert_not_null(events[i], "Failed to enqueue event %d", i);
	}

	/* Verify: normal events first, then resume events */
	while ((current = ull_prepare_dequeue_iter(&idx)) != NULL) {
		if (found_resume) {
			/* After first resume, all should be resume */
			zassert_equal(current->is_resume, 1,
				     "Non-resume event found after resume events");
		}
		if (current->is_resume) {
			found_resume = true;
		}
	}
}

/* Test suite setup/teardown */
static void *test_ull_prepare_ordering_setup(void)
{
	return NULL;
}

static void test_ull_prepare_ordering_before(void *f)
{
	/* Initialize pipeline state */
	ull_prepare_pipeline_init();
}

static void test_ull_prepare_ordering_after(void *f)
{
	/* Cleanup pipeline */
	ull_prepare_pipeline_cleanup();
}

static void test_ull_prepare_ordering_teardown(void *f)
{
}

ZTEST_SUITE(test_ull_prepare_ordering, NULL,
	   test_ull_prepare_ordering_setup,
	   test_ull_prepare_ordering_before,
	   test_ull_prepare_ordering_after,
	   test_ull_prepare_ordering_teardown);
```

## src/ull_prepare_impl.c
```c
/*
 * Copyright (c) 2024 Nordic Semiconductor ASA
 *
 * SPDX-License-Identifier: Apache-2.0
 */

/**
 * @file
 * @brief Test implementation of ULL prepare pipeline
 *
 * This file provides a minimal implementation of the prepare pipeline
 * functions for unit testing. It includes only the prepare pipeline
 * functions from ull.c without the full ULL dependencies.
 */

#include <string.h>
#include <zephyr/types.h>

#include "util/util.h"
#include "util/mem.h"

#include "lll.h"

/* BIT macro if not already defined */
#ifndef BIT
#define BIT(n) (1UL << (n))
#endif

/* Ticker constants - for testing we use 32-bit counter */
#define HAL_TICKER_CNTR_MSBIT 31
#define HAL_TICKER_CNTR_MASK 0xFFFFFFFF

/* Ticker tick difference calculation */
static inline uint32_t ticker_ticks_diff_get(uint32_t ticks_now, uint32_t ticks_old)
{
	return ((ticks_now - ticks_old) & HAL_TICKER_CNTR_MASK);
}

/* Event pipeline maximum size - use value from lll.h if available */
#ifndef EVENT_PIPELINE_MAX
#define EVENT_PIPELINE_MAX (7U + (EVENT_DEFER_MAX))
#endif

#define EVENT_PIPELINE_EVENT_SIZE (sizeof(struct lll_event) + sizeof(void *))

/* Prepare pipeline structure */
static struct {
	struct {
		void *free;
		uint8_t pool[EVENT_PIPELINE_MAX * EVENT_PIPELINE_EVENT_SIZE];
	} mem;
	void **head;
	void **tail;
} pipeline;

/* Initialize the prepare pipeline */
void ull_prepare_pipeline_init(void)
{
	mem_init(pipeline.mem.pool, EVENT_PIPELINE_EVENT_SIZE,
		 sizeof(pipeline.mem.pool) / EVENT_PIPELINE_EVENT_SIZE,
		 &pipeline.mem.free);
	pipeline.head = NULL;
	pipeline.tail = NULL;
}

/* Reset/cleanup the prepare pipeline */
void ull_prepare_pipeline_cleanup(void)
{
	/* Free all allocated events */
	void **curr = pipeline.head;
	while (curr) {
		void **next = *curr;
		mem_release(curr, &pipeline.mem.free);
		curr = next;
	}
	
	pipeline.head = NULL;
	pipeline.tail = NULL;
}

struct lll_event *ull_prepare_enqueue(lll_is_abort_cb_t is_abort_cb,
				      lll_abort_cb_t abort_cb,
				      struct lll_prepare_param *prepare_param,
				      lll_prepare_cb_t prepare_cb,
				      uint8_t is_resume)
{
	struct lll_event *e;
	void **next;

	/* Allocate lll_event */
	next = mem_acquire(&pipeline.mem.free);
	if (!next) {
		return NULL;
	}

	e = (void *)((uint8_t *)next + sizeof(void *));

	memcpy(&e->prepare_param, prepare_param, sizeof(e->prepare_param));
	e->prepare_cb = prepare_cb;
	e->is_abort_cb = is_abort_cb;
	e->abort_cb = abort_cb;
	e->is_resume = is_resume;
	e->is_aborted = 0U;

	/* Enqueue lll_event */
	*next = NULL;
	if (pipeline.tail) {
		struct lll_event *e_curr;
		uint32_t diff;

		/* Should the prepare be placed as the tail? */
		e_curr = (void *)((uint8_t *)pipeline.tail + sizeof(void *));
		diff = ticker_ticks_diff_get(prepare_param->ticks_at_expire,
					     e_curr->prepare_param.ticks_at_expire);
		if (is_resume ||
		    (!e_curr->is_aborted && !e_curr->is_resume &&
		     ((diff & BIT(HAL_TICKER_CNTR_MSBIT)) == 0U))) {
			*pipeline.tail = next;
			pipeline.tail = next;
		} else {
			/* Should the prepare be placed as the head? */
			e_curr = (void *)((uint8_t *)pipeline.head + sizeof(void *));
			diff = ticker_ticks_diff_get(e_curr->prepare_param.ticks_at_expire,
						     prepare_param->ticks_at_expire);
			if (!e_curr->is_aborted &&
			    (e_curr->is_resume ||
			     (diff && ((diff & BIT(HAL_TICKER_CNTR_MSBIT)) == 0U)))) {
				*next = pipeline.head;
				pipeline.head = next;
			} else {
				void **prev;
				void **curr;

				prev = NULL;
				curr = pipeline.head;
				e_curr = (void *)((uint8_t *)curr + sizeof(void *));
				do {
					if (!e_curr->is_aborted && !e_curr->is_resume) {
						prev = curr;
					}

					curr = *curr;
					if (!curr) {
						break;
					}

					e_curr = (void *)((uint8_t *)curr + sizeof(void *));
					diff = ticker_ticks_diff_get(
							prepare_param->ticks_at_expire,
							e_curr->prepare_param.ticks_at_expire);
				} while (!e_curr->is_resume &&
					 (e_curr->is_aborted ||
					  ((diff & BIT(HAL_TICKER_CNTR_MSBIT)) == 0U)));

				if (!prev) {
					*next = pipeline.head;
					pipeline.head = next;
					if (!*next) {
						pipeline.tail = next;
					}
				} else {
					*next = *prev;
					*prev = next;
					if (!*next) {
						pipeline.tail = next;
					}
				}
			}
		}
	} else {
		pipeline.head = next;
		pipeline.tail = next;
	}

	return e;
}

void *ull_prepare_dequeue_get(void)
{
	void *e;

	/* peak lll_event */
	if (pipeline.head) {
		e = (uint8_t *)pipeline.head + sizeof(void *);
	} else {
		e = NULL;
	}

	return e;
}

void *ull_prepare_dequeue_iter(void **idx)
{
	void *e;

	/* Start at the head */
	if (!*idx) {
		*idx = pipeline.head;
	}

	/* No more in the list */
	if (!*idx) {
		return NULL;
	}

	/* Peak lll_event */
	e = (uint8_t *)*idx + sizeof(void *);

	/* Proceed to next */
	*idx = *((void **)*idx);

	return e;
}

void ull_prepare_dequeue(uint8_t caller_id)
{
	/* For testing, we just need a stub implementation
	 * Full implementation would require mayfly, ticker, etc.
	 */
	(void)caller_id;
}
```

## samples/bluetooth/bap_broadcast_source/boards/nrf21540dk_nrf52840.conf
```kconfig
# Use USB Audio as audio source
CONFIG_USE_USB_AUDIO_INPUT=y
CONFIG_SAMPLE_USBD_PRODUCT="USB Broadcast Source sample"

CONFIG_BT_CTLR_TX_PWR_PLUS_8=y
```

## samples/bluetooth/observer_broadcaster_multiple/boards/nrf54lm20dk_nrf54lm20a_cpuapp.conf
```kconfig
CONFIG_SRAM_VECTOR_TABLE=y
CONFIG_CODE_DATA_RELOCATION=y
CONFIG_CODE_DATA_RELOCATION_SRAM=y
```

## tests/bluetooth/controller/ctrl_cs/testcase.yaml
```yaml
common:
  tags:
    - bluetooth
    - bt_channel_sounding
    - bt_ull_llcp
tests:
  bluetooth.controller.ctrl_cs.test:
    type: unit
```

## tests/bluetooth/controller/ctrl_prepare_pipeline/testcase.yaml
```yaml
common:
  tags:
    - bluetooth
    - bt_controller
    - bt_ull
tests:
  bluetooth.ctrl_prepare_pipeline.test:
    type: unit
    tags:
      - bluetooth_controller
      - prepare_pipeline
```

## tests/bluetooth/controller/lll_prepare_resolve/testcase.yaml
```yaml
common:
  tags: bluetooth
tests:
  bluetooth.controller.lll_prepare_resolve:
    platform_allow:
      - native_sim
    integration_platforms:
      - native_sim
```

## tests/bluetooth/controller/radio_nrf54hx_mram/Kconfig
```kconfig
# Copyright (c) 2025 Nordic Semiconductor ASA
# SPDX-License-Identifier: Apache-2.0

# Include Zephyr's Kconfig
source "Kconfig"
```

## tests/bluetooth/controller/radio_nrf54hx_mram/testcase.yaml
```yaml
common:
  tags:
    - bluetooth
    - bluetooth_controller
  harness: ztest

tests:
  bluetooth.controller.radio_nrf54hx_mram.test:
    type: unit
```

## tests/bsim/bluetooth/host/adv/decision/testcase.yaml
```yaml
common:
  build_only: true
  tags:
    - bluetooth
  platform_allow:
    - nrf52_bsim/native
    - nrf5340bsim/nrf5340/cpunet
  harness: bsim

tests:
  bluetooth.host.adv.decision.broadcaster:
    harness_config:
      bsim_exe_name: tests_bsim_bluetooth_host_adv_decision_prj_broadcaster_conf
    extra_args:
      CONF_FILE=prj_broadcaster.conf
  bluetooth.host.adv.decision.observer:
    harness_config:
      bsim_exe_name: tests_bsim_bluetooth_host_adv_decision_prj_observer_conf
    extra_args:
      CONF_FILE=prj_observer.conf
```

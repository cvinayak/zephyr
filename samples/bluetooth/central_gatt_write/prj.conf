## Kconfig.gatt_write
```
# Copyright (c) 2025 Nordic Semiconductor ASA
# SPDX-License-Identifier: Apache-2.0

config USE_FIXED_LENGTH_DATA
	bool "Use fixed length data in GATT Write without Response"
	help
	  Use fixed length data in GATT Write without Response otherwise
	  determine the maximum GATT MTU size to use.

config USE_FIXED_LENGTH_DATA_LEN
	int "Fixed length data length"
	default 0
	help
	  Fixed length data length to use in GATT Write without Response.

config USE_VARIABLE_LENGTH_DATA
	bool "Use variable length data in GATT Write without Response"
	depends on !USE_FIXED_LENGTH_DATA
	help
	  Use increasing and decreasing length data in GATT Write without
	  Response.

config USE_CONN_UPDATE_ITERATION_ONCE
	bool "Test Connection Update"
	help
	  Perform Connection Update for a single iteration.

config USE_PHY_UPDATE_ITERATION_ONCE
	bool "Test PHY Update"
	depends on BT_USER_PHY_UPDATE
	help
	  Perform PHY Update for a single iteration.

config USE_NOTIFY
	bool "Use GATT Notifications instead of Write without Response"
	help
	  Exercise the GATT Notification throughput path instead of GATT Write
	  without Response. The peripheral streams notifications and the central
	  subscribes and receives them. With USE_FULL_DUPLEX both peers subscribe
	  to and notify each other; otherwise only the peripheral notifies
	  (one-directional). When disabled (default), both peers transmit GATT
	  Write without Response commands.

config USE_FULL_DUPLEX
	bool "Exercise full-duplex (bidirectional) throughput"
	depends on USE_NOTIFY
	default y
	help
	  Drive throughput from both peers simultaneously. For GATT Write without
	  Response this is the inherent behaviour. For GATT Notifications
	  (USE_NOTIFY) both peers subscribe to and notify each other instead of
	  the one-directional peripheral-to-central path. Full-duplex transfers
	  help uncover stack regressions such as deadlocks/livelocks (for example
	  on supervision timeout) under simultaneous bidirectional load. Disable
	  to exercise the one-directional (simplex) notify path.
```

## prj.conf
```kconfig
CONFIG_BT=y
CONFIG_BT_CENTRAL=y
CONFIG_BT_SMP=y
CONFIG_BT_GATT_CLIENT=y

CONFIG_BT_BUF_ACL_RX_SIZE=255
CONFIG_BT_BUF_ACL_TX_SIZE=251
CONFIG_BT_BUF_CMD_TX_SIZE=255
CONFIG_BT_BUF_EVT_DISCARDABLE_SIZE=255

# Maximum L2CAP size for one LL PDU size
CONFIG_BT_L2CAP_TX_MTU=247

# Auto initiated PHY update on connection established
CONFIG_BT_AUTO_PHY_CENTRAL_2M=y
# Enable user initiated PHY update support
# CONFIG_BT_USER_PHY_UPDATE=y

# Auto initiated Data Length update on connection established
CONFIG_BT_AUTO_DATA_LEN_UPDATE=y
# Enable user initiated Data Length update support
CONFIG_BT_USER_DATA_LEN_UPDATE=y

CONFIG_USE_VARIABLE_LENGTH_DATA=y
CONFIG_USE_FIXED_LENGTH_DATA=n
CONFIG_USE_FIXED_LENGTH_DATA_LEN=251

# Use link time optimization for code size reduction
CONFIG_ISR_TABLES_LOCAL_DECLARATION=y
CONFIG_LTO=y

# Generate .lst file, to find HCI h/w error event given PC
CONFIG_OUTPUT_DISASSEMBLY=y
CONFIG_OUTPUT_DISASSEMBLY_WITH_SOURCE=y

CONFIG_BT_USE_DEBUG_KEYS=y

CONFIG_BT_CONN_PARAM_ANY=y

# CONFIG_ZERO_LATENCY_IRQS=y
# CONFIG_BT_CTLR_ZLI=y

CONFIG_BT_CTLR_ADVANCED_FEATURES=y
CONFIG_BT_CTLR_CONN_INTERVAL_LOW_LATENCY=y
# CONFIG_BT_CTLR_EVENT_IFS_LOW_LAT_US=52
CONFIG_BT_CTLR_TIFS_LOWEST=y

CONFIG_BT_CTLR_LLL_PRIO=0
CONFIG_BT_CTLR_ULL_HIGH_PRIO=1
CONFIG_BT_CTLR_ULL_LOW_PRIO=2

# CONFIG_BT_CTLR_LLL_PREPARE_AT_MARGIN=n

# CONFIG_BT_CTLR_DATA_LENGTH_MAX=251

# CONFIG_BT_CTLR_CONN_RSSI=y
# CONFIG_BT_CTLR_CONN_RSSI_EVENT=y

# Enable Extended Scanning
# CONFIG_BT_EXT_ADV=y
# CONFIG_BT_EXT_SCAN_BUF_SIZE=1650

# Zephyr Bluetooth LE Controller needs 16 event buffers to generate Extended
# Advertising Report for receiving the complete 1650 bytes of data
# CONFIG_BT_BUF_EVT_RX_COUNT=16

# Set maximum scan data length for Extended Scanning in Bluetooth LE Controller
# CONFIG_BT_CTLR_SCAN_DATA_LEN_MAX=1650

# Increase Zephyr Bluetooth LE Controller Rx buffer to receive complete chain
# of PDUs
# CONFIG_BT_CTLR_RX_BUFFERS=9

# CONFIG_BT_CTLR_PHY_CODED=y

# CONFIG_BT_CTLR_ADVANCED_FEATURES=y
# CONFIG_BT_CTLR_LOW_LAT_ULL=y
# CONFIG_BT_CTLR_SCAN_AUX_SET=9
# CONFIG_BT_CTLR_SCAN_UNRESERVED=y

# CONFIG_BT_CTLR_ADVANCED_FEATURES=y
# CONFIG_BT_CTLR_ASSERT_OVERHEAD_START=n

CONFIG_BT_CTLR_ASSERT_OPTIMIZE_FOR_SIZE=n
CONFIG_LOG=y
```

## src/central_gatt_write.c
```c
/*
 * Copyright (c) 2022 Nordic Semiconductor ASA
 *
 * SPDX-License-Identifier: Apache-2.0
 */

#include <zephyr/kernel.h>
#include <zephyr/sys/printk.h>

#include <zephyr/bluetooth/bluetooth.h>
#include <zephyr/bluetooth/conn.h>
#include <zephyr/bluetooth/gatt.h>
#include <zephyr/bluetooth/hci.h>

#include "gatt_write.h"

#if defined(CONFIG_BT_EXT_ADV)
#define NAME_LEN 30

static bool data_cb(struct bt_data *data, void *user_data)
{
	char *name = user_data;
	uint8_t len;

	switch (data->type) {
	case BT_DATA_NAME_SHORTENED:
	case BT_DATA_NAME_COMPLETE:
		len = MIN(data->data_len, NAME_LEN - 1);
		(void)memcpy(name, data->data, len);
		name[len] = '\0';
		return false;
	default:
		return true;
	}
}

static const char *phy2str(uint8_t phy)
{
	switch (phy) {
	case BT_GAP_LE_PHY_NONE: return "No packets";
	case BT_GAP_LE_PHY_1M: return "LE 1M";
	case BT_GAP_LE_PHY_2M: return "LE 2M";
	case BT_GAP_LE_PHY_CODED: return "LE Coded";
	default: return "Unknown";
	}
}

static void scan_recv(const struct bt_le_scan_recv_info *info,
		      struct net_buf_simple *buf)
{
	char le_addr[BT_ADDR_LE_STR_LEN];
	char name[NAME_LEN];
	uint8_t data_status;
	uint16_t data_len;

	(void)memset(name, 0, sizeof(name));

	data_len = buf->len;
	bt_data_parse(buf, data_cb, name);

	data_status = BT_HCI_LE_ADV_EVT_TYPE_DATA_STATUS(info->adv_props);

	bt_addr_le_to_str(info->addr, le_addr, sizeof(le_addr));
	printk("[DEVICE]: %s, AD evt type %u, Tx Pwr: %i, RSSI %i "
	       "Data status: %u, AD data len: %u Name: %s "
	       "C:%u S:%u D:%u SR:%u E:%u Pri PHY: %s, Sec PHY: %s, "
	       "Interval: 0x%04x (%u ms), SID: %u\n",
	       le_addr, info->adv_type, info->tx_power, info->rssi,
	       data_status, data_len, name,
	       (info->adv_props & BT_GAP_ADV_PROP_CONNECTABLE) != 0,
	       (info->adv_props & BT_GAP_ADV_PROP_SCANNABLE) != 0,
	       (info->adv_props & BT_GAP_ADV_PROP_DIRECTED) != 0,
	       (info->adv_props & BT_GAP_ADV_PROP_SCAN_RESPONSE) != 0,
	       (info->adv_props & BT_GAP_ADV_PROP_EXT_ADV) != 0,
	       phy2str(info->primary_phy), phy2str(info->secondary_phy),
	       info->interval, info->interval * 5 / 4, info->sid);
}

static struct bt_le_scan_cb scan_callbacks = {
	.recv = scan_recv,
};
#endif /* CONFIG_BT_EXT_ADV */

static void device_found(const bt_addr_le_t *addr, int8_t rssi, uint8_t type,
			 struct net_buf_simple *ad)
{
	struct bt_conn *conn;
	int err;

	printk("[DEVICE]: %s, AD evt type %u, AD data len %u, RSSI %i\n",
	       bt_addr_le_str(addr), type, ad->len, rssi);

	/* If already connected, do nothing */
	if (conn_connected) {
		return;
	}

	/* We're only interested in connectable events */
	if (type != BT_GAP_ADV_TYPE_ADV_IND &&
	    type != BT_GAP_ADV_TYPE_ADV_DIRECT_IND) {
		return;
	}

	/* connect only to devices in close proximity */
	if (rssi < -50) {
		return;
	}

	err = bt_le_scan_stop();
	if (err) {
		printk("%s: Stop LE scan failed (err %d)\n", __func__, err);
		return;
	}

	err = bt_conn_le_create(addr, BT_CONN_LE_CREATE_CONN,
				BT_LE_CONN_PARAM_DEFAULT, &conn);
	if (err) {
		printk("%s: Create conn failed (err %d)\n", __func__, err);
		start_scan_func();
	} else {
		bt_conn_unref(conn);
	}
}

static void start_scan(void)
{
	struct bt_le_scan_param scan_param = {
		.type       = BT_LE_SCAN_TYPE_ACTIVE,
		.options    = BT_LE_SCAN_OPT_CODED,
		.interval   = 0x0010,
		.window     = 0x0010,
	};
	int err;

scan_start_retry:
	printk("Starting scanning...\n");
	err = bt_le_scan_start(&scan_param, device_found);
	if (err) {
		if ((scan_param.options & BT_LE_SCAN_OPT_CODED) != 0U) {
			printk("Failed to start scanning with Coded PHY (err %d), retrying "
			       "without...\n", err);

			scan_param.options &= ~BT_LE_SCAN_OPT_CODED;

			goto scan_start_retry;
		}

		printk("Start scanning failed (err %d)\n", err);

		return;
	}

	printk("success.\n");
}

void mtu_updated(struct bt_conn *conn, uint16_t tx, uint16_t rx)
{
	printk("Updated MTU: TX: %d RX: %d bytes\n", tx, rx);
}

static struct bt_gatt_cb gatt_callbacks = {
	.att_mtu_updated = mtu_updated
};

uint32_t central_gatt_write(uint32_t count)
{
	int err;

	err = bt_enable(NULL);
	if (err) {
		printk("Bluetooth init failed (err %d)\n", err);
		return 0U;
	}
	printk("Bluetooth initialized\n");

	bt_gatt_cb_register(&gatt_callbacks);

	conn_connected = NULL;
	last_write_rate = 0U;
	write_countdown = &count;

	if (IS_ENABLED(CONFIG_USE_NOTIFY) && !IS_ENABLED(CONFIG_USE_FULL_DUPLEX)) {
		notify_rx_window_start(count);
	}

	if (count != 0U) {
		printk("GATT Write countdown %u on connection.\n", count);
	} else {
		printk("GATT Write forever on connection.\n");
	}

#if defined(CONFIG_BT_USER_PHY_UPDATE)
	err = bt_conn_le_set_default_phy(BT_GAP_LE_PHY_1M, BT_GAP_LE_PHY_1M);
	if (err) {
		printk("Failed to set default PHY (err %d)\n", err);
		return 0U;
	}
#endif /* CONFIG_BT_USER_PHY_UPDATE */

#if defined(CONFIG_BT_EXT_ADV)
	bt_le_scan_cb_register(&scan_callbacks);
	printk("Registered scan callbacks\n");
#endif /* CONFIG_BT_EXT_ADV */

	start_scan_func = start_scan;
	start_scan_func();

	while (true) {
		/* Simplex notify: the central only receives, so it completes on
		 * its RX window instead of the TX countdown below.
		 */
		if (notify_rx_window_done()) {
			break;
		}

		if (conn_connected == NULL) {
			(void)k_sleep(K_SECONDS(1));
			continue;
		}

		/* Hold a reference across the transmit so the connection is not
		 * freed by the disconnected callback mid-transmit. bt_conn_ref()
		 * returns NULL if the connection was torn down concurrently.
		 */
		struct bt_conn *conn = conn_connected;

		if (conn != NULL) {
			conn = bt_conn_ref(conn);
		}

		if (conn == NULL) {
			continue;
		}

		if (IS_ENABLED(CONFIG_USE_NOTIFY)) {
			err = notify_poll(conn) ? notify_data(conn) : -EAGAIN;
			if (err != 0) {
				/* Not ready (-EAGAIN), out of buffers (-ENOMEM) or
				 * the link is going down: back off one connection
				 * interval. Sleeping (not yielding) lets time
				 * advance so a pending disconnect is delivered.
				 */
				k_timeout_t delay = conn_interval_get(conn);

				bt_conn_unref(conn);
				(void)k_sleep(delay);
				continue;
			}
		} else {
			err = write_cmd(conn);
			if (err != 0 && err != -ENOMEM) {
				/* -ENOMEM just means no TX buffer was free this
				 * iteration and is retried on the next one; any
				 * other error is unexpected.
				 */
				printk("%s: write_cmd failed (%d)\n", __func__, err);
			}
		}

		bt_conn_unref(conn);

		/* Passing `0` will not use the countdown; the block below is
		 * optimized out by the linker in that case.
		 */
		if (count != 0U) {
			if ((count % 1000U) == 0U) {
				printk("GATT %s countdown %u\n",
				       IS_ENABLED(CONFIG_USE_NOTIFY) ? "Notify" : "Write",
				       count);
			}

			count--;
			if (count == 0U) {
				break;
			}
		}

		k_yield();
	}

	return last_write_rate;
}
```

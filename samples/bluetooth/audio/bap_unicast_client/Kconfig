## samples/bluetooth/audio/bap_unicast_client/Kconfig
```kconfig
# Copyright (c) 2025 Nordic Semiconductor ASA
# SPDX-License-Identifier: Apache-2.0

mainmenu "Bluetooth: BAP Unicast Client"

config INFO_REPORTING_INTERVAL
	int "Number of SDUs received between each information report"
	default 1000
	help
	  Determines how often information about received data is logged.
	  Set to 0 to disable reporting.

config ISO_PACKING_INTERLEAVED
	bool "Use interleaved packing"
	help
	  Use interleaved packing between CIS ISO stream subevents.

choice AUDIO_IO
	prompt "Audio input and output"
	default USE_USB_AUDIO if DT_HAS_ZEPHYR_UAC2_ENABLED
	default USE_SINE_AUDIO
	help
	  Source of the audio sent on the sink streams and destination of the
	  audio received on the source streams.

config USE_SINE_AUDIO
	bool "Sine tone"
	help
	  Encode a sine tone when LC3 is enabled, and only count the received
	  audio.

config USE_USB_AUDIO
	bool "USB headset"
	depends on DT_HAS_ZEPHYR_UAC2_ENABLED
	select LIBLC3
	select FPU
	select USB_DEVICE_STACK_NEXT
	select USBD_AUDIO2_CLASS
	help
	  Appear as a USB headset to the USB host. Speaker audio from the host
	  is encoded on the left and right sink streams; the source stream is
	  decoded and sent to the host as the microphone.

endchoice

choice SINK_PRESET
	prompt "LC3 preset of the sink streams"
	default SINK_PRESET_48_2_1 if USE_USB_AUDIO && SOC_NRF5340_CPUAPP
	default SINK_PRESET_24_2_1 if USE_USB_AUDIO
	default SINK_PRESET_16_2_1

config SINK_PRESET_16_2_1
	bool "16_2_1"

config SINK_PRESET_24_2_1
	bool "24_2_1"

config SINK_PRESET_48_2_1
	bool "48_2_1"

endchoice

choice SOURCE_PRESET
	prompt "LC3 preset of the source streams"
	default SOURCE_PRESET_16_2_1

config SOURCE_PRESET_16_2_1
	bool "16_2_1"

config SOURCE_PRESET_24_2_1
	bool "24_2_1"

endchoice

if USE_USB_AUDIO

config SAMPLE_USBD_PRODUCT
	default "LE Audio Unicast Client headset"

# Source common USB sample options used to initialize new experimental USB device stack.
# The scope of these options is limited to USB samples in project tree,
# you cannot use them in your own application.
source "samples/subsys/usb/common/Kconfig.sample_usbd"

endif # USE_USB_AUDIO

source "Kconfig.zephyr"
```

## samples/bluetooth/hci_ipc/boards/nrf54h20dk_nrf54h20_cpurad.conf
```kconfig
CONFIG_MAIN_STACK_SIZE=2048

CONFIG_LOG=y
CONFIG_LOG_BUFFER_SIZE=4096

# CONFIG_SRAM_VECTOR_TABLE=y
# CONFIG_CODE_DATA_RELOCATION=y
# CONFIG_CODE_DATA_RELOCATION_SRAM=y
```

## soc/nordic/common/vpr/Kconfig
```kconfig
# Copyright (c) 2024 Nordic Semiconductor ASA
# SPDX-License-Identifier: Apache-2.0

config RISCV_CORE_NORDIC_VPR
	bool
	select RISCV
	select RISCV_PRIVILEGED
	select RISCV_VECTORED_MODE
	select RISCV_SOC_HAS_GP_RELATIVE_ADDRESSING
	select RISCV_HAS_CLIC
	select RISCV_SOC_CONTEXT_SAVE
	select HAS_FLASH_LOAD_OFFSET
	select ARCH_HAS_CUSTOM_CPU_IDLE
	select ARCH_HAS_CUSTOM_CPU_ATOMIC_IDLE
	select INCLUDE_RESET_VECTOR
	imply XIP
	imply SHELL_REMOTE_CLI_SKIP_RO_STRINGS
	help
	  Enable support for the RISC-V Nordic VPR core.

config NORDIC_VPR_HW_STACKING
	bool "Hardware register stacking on interrupts"
	depends on RISCV_CORE_NORDIC_VPR
	select RISCV_SOC_HAS_ISR_STACKING
	help
	  Use the VPR hardware to save and restore part of the interrupted
	  context (ra, t0-t2, a0-a5, mcause and mepc) on interrupt entry and
	  exit.

	  When disabled (default), hardware register stacking is turned off
	  at boot and the Zephyr kernel saves and restores the complete
	  interrupted context in software when handling interrupts. This
	  allows interrupts to be re-enabled only once the context has been
	  fully saved, which is required for nested interrupts, see
	  RISCV_NESTED_INTERRUPTS.

choice NORDIC_VPR_SLEEP_MODE
	prompt "Default sleep mode"
	depends on RISCV_CORE_NORDIC_VPR
	default NORDIC_VPR_SLEEP if SOC_NRF54H20_CPUFLPR
	default NORDIC_VPR_DEEPSLEEP if SOC_NRF54H20_CPUPPR
	default NORDIC_VPR_HIBERNATE

config NORDIC_VPR_SLEEP
	bool "Sleep"
	help
	  Significantly higher power consumption but very short wake up time.

config NORDIC_VPR_DEEPSLEEP
	bool "Deep sleep"
	depends on SOC_NRF54H20_CPUPPR
	help
	  Deep sleep can reach less than 5 uA in system-on-idle state only on nRF54H20.
	  Wake up time is comparable to the 'sleep' mode.

config NORDIC_VPR_HIBERNATE
	bool "Hibernation"
	depends on !SOC_SERIES_NRF54H && !SOC_SERIES_NRF92
	help
	  It has the lowest power consumption and it must be used to reach less than 5 uA in
	  the system-on-idle state on targets other than nRF54H20. It has slightly longer
	  wake up time (additional 1 us). Hibernation is using a RAM block to store the VPR
	  state and parent core must configure the memory so that it is powered on and retained.

endchoice
```

## tests/bluetooth/controller/ctrl_cs_drbg/testcase.yaml
```yaml
common:
  tags:
    - bluetooth
    - bt_channel_sounding
tests:
  bluetooth.controller.ctrl_cs_drbg.test:
    type: unit
```

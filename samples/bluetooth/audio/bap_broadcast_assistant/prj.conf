## prj.conf
```kconfig
CONFIG_BT=y
CONFIG_LOG=y
CONFIG_BT_CENTRAL=y
CONFIG_BT_GATT_CLIENT=y
CONFIG_BT_GATT_AUTO_DISCOVER_CCC=y
CONFIG_BT_GATT_AUTO_UPDATE_MTU=y
CONFIG_UTF8=y
CONFIG_BT_AUDIO=y
CONFIG_BT_SMP=y
CONFIG_BT_BUF_ACL_RX_SIZE=255
CONFIG_BT_BUF_ACL_TX_SIZE=251
CONFIG_BT_CTLR_SCAN_DATA_LEN_MAX=191

CONFIG_BT_EXT_ADV=y
CONFIG_BT_PER_ADV_SYNC=y
CONFIG_BT_BAP_BASS_MAX_SUBGROUPS=2
CONFIG_BT_ISO_SYNC_RECEIVER=y
CONFIG_BT_BAP_BROADCAST_ASSISTANT=y
CONFIG_BT_AUDIO_CODEC_CFG_MAX_METADATA_SIZE=255

CONFIG_BT_USE_DEBUG_KEYS=y
```

## src/main.c
```c
/*
 * Copyright (c) 2024 Demant A/S
 * Copyright (c) 2024-2026 Nordic Semiconductor ASA
 *
 * SPDX-License-Identifier: Apache-2.0
 */

#include <errno.h>
#include <stdbool.h>
#include <stddef.h>
#include <stdint.h>
#include <string.h>
#include <strings.h>

#include <zephyr/autoconf.h>
#include <zephyr/bluetooth/addr.h>
#include <zephyr/bluetooth/assigned_numbers.h>
#include <zephyr/bluetooth/audio/audio.h>
#include <zephyr/bluetooth/audio/bap.h>
#include <zephyr/bluetooth/bluetooth.h>
#include <zephyr/bluetooth/conn.h>
#include <zephyr/bluetooth/gap.h>
#include <zephyr/bluetooth/hci.h>
#include <zephyr/bluetooth/hci_types.h>
#include <zephyr/bluetooth/iso.h>
#include <zephyr/bluetooth/uuid.h>
#include <zephyr/kernel.h>
#include <zephyr/net_buf.h>
#include <zephyr/sys/__assert.h>
#include <zephyr/sys/byteorder.h>
#include <zephyr/sys/printk.h>
#include <zephyr/sys/util.h>
#include <zephyr/toolchain.h>
#include <zephyr/types.h>

#define NAME_LEN                          30U
#define PA_SYNC_SKIP                      5U
#define PA_SYNC_INTERVAL_TO_TIMEOUT_RATIO 20U /* Set the timeout relative to interval */
/* Broadcast IDs are 24bit, so this is out of valid range */
/* Default semaphore timeout when waiting for an action */
#define SEM_TIMEOUT                       K_SECONDS(10U)

static void scan_for_broadcast_sink(void);

/* Struct to collect information from scanning
 * for Broadcast Source or Sink
 */
struct broadcast_source_info {
	char bt_name[NAME_LEN];
	char broadcast_name[NAME_LEN];
	uint32_t broadcast_id;
};

struct scan_delegator_info {
	char bt_name[NAME_LEN];
	bool has_svc_data;
};

static struct bt_conn *broadcast_sink_conn;
static uint8_t remote_recv_state_count;
static uint32_t selected_broadcast_id;
static uint8_t selected_sid;
static uint16_t selected_pa_interval;
static bt_addr_le_t selected_addr;
static struct bt_le_per_adv_sync *pa_sync;
static uint8_t received_base[UINT8_MAX];
static size_t received_base_size;
static struct bt_bap_bass_subgroup
	bass_subgroups[CONFIG_BT_BAP_BASS_MAX_SUBGROUPS];

static bool scanning_for_broadcast_source;

static struct k_mutex base_store_mutex;
static K_SEM_DEFINE(sem_source_discovered, 0U, 1U);
static K_SEM_DEFINE(sem_sink_discovered, 0U, 1U);
static K_SEM_DEFINE(sem_sink_connected, 0U, 1U);
static K_SEM_DEFINE(sem_sink_disconnected, 0U, 1U);
static K_SEM_DEFINE(sem_security_updated, 0U, 1U);
static K_SEM_DEFINE(sem_bass_discovered, 0U, 1U);
static K_SEM_DEFINE(sem_recv_state_read, 0U, 1U);
static K_SEM_DEFINE(sem_pa_synced, 0U, 1U);
static K_SEM_DEFINE(sem_pa_sync_terminted, 0U, 1U);
static K_SEM_DEFINE(sem_received_base_subgroups, 0U, 1U);

static bool parse_broadcast_source_data(struct bt_data *data, void *user_data)
{
	struct broadcast_source_info *info = (struct broadcast_source_info *)user_data;
	struct bt_uuid_16 adv_uuid;

	switch (data->type) {
	case BT_DATA_NAME_SHORTENED:
	case BT_DATA_NAME_COMPLETE:
		memcpy(info->bt_name, data->data, MIN(data->data_len, NAME_LEN - 1));
		return true;
	case BT_DATA_BROADCAST_NAME:
		memcpy(info->broadcast_name, data->data, MIN(data->data_len, NAME_LEN - 1));
		return true;
	case BT_DATA_SVC_DATA16:
		/* Check for Broadcast ID */
		if (data->data_len < BT_UUID_SIZE_16 + BT_AUDIO_BROADCAST_ID_SIZE) {
			return true;
		}

		if (!bt_uuid_create(&adv_uuid.uuid, data->data, BT_UUID_SIZE_16)) {
			return true;
		}

		if (bt_uuid_cmp(&adv_uuid.uuid, BT_UUID_BROADCAST_AUDIO) == 0) {
			info->broadcast_id = sys_get_le24(data->data + BT_UUID_SIZE_16);
		}

		return true;
	default:
		return true;
	}

	if (info->broadcast_id != BT_BAP_INVALID_BROADCAST_ID && info->bt_name[0] != '\0' &&
	    info->broadcast_name[0] != '\0') {
		/* We have found all we are looking for, stop parsing */
		return false;
	}
}

static bool parse_scan_delegator_data(struct bt_data *data, void *user_data)
{
	struct scan_delegator_info *info = (struct scan_delegator_info *)user_data;
	struct bt_uuid_16 adv_uuid;

	switch (data->type) {
	case BT_DATA_NAME_SHORTENED:
	case BT_DATA_NAME_COMPLETE:
		memcpy(info->bt_name, data->data, MIN(data->data_len, NAME_LEN - 1));
		return true;
	case BT_DATA_SVC_DATA16:
		/* NOTE: According to the BAP 1.0.2 Spec,
		 * Section 3.9.2. Additional Broadcast Audio Scan Service requirements,
		 * If the Scan Delegator implements a Broadcast Sink, it shall transmit the BASS
		 * UUID as service data.
		 */

		if (data->data_len < BT_UUID_SIZE_16) {
			return true;
		}

		if (!bt_uuid_create(&adv_uuid.uuid, data->data, BT_UUID_SIZE_16)) {
			return true;
		}

		if (bt_uuid_cmp(&adv_uuid.uuid, BT_UUID_BASS) == 0) {
			info->has_svc_data = true;
		}

		return true;
	default:
		return true;
	}

	if (info->has_svc_data && info->bt_name[0] != '\0') {
		/* We have found all we are looking for, stop parsing */
		return false;
	}
}

static bool base_store(struct bt_data *data, void *user_data)
{
	const struct bt_bap_base *base = bt_bap_base_get_base_from_ad(data);
	int base_size;
	int base_subgroup_count;
	int err;

	ARG_UNUSED(user_data);

	/* Base is NULL if the data does not contain a valid BASE */
	if (base == NULL) {
		return true;
	}

	/* Can not fit all the received subgroups with the size CONFIG_BT_BAP_BASS_MAX_SUBGROUPS */
	base_subgroup_count = bt_bap_base_get_subgroup_count(base);
	if (base_subgroup_count < 0 || base_subgroup_count > CONFIG_BT_BAP_BASS_MAX_SUBGROUPS) {
		printk("Got invalid subgroup count: %d\n", base_subgroup_count);
		return true;
	}

	base_size = bt_bap_base_get_size(base);
	if (base_size < 0) {
		printk("BASE get size failed (%d)\n", base_size);

		return true;
	}

	/* Compare BASE and copy if different */
	err = k_mutex_lock(&base_store_mutex, K_MSEC(100));
	if (err != 0) {
		/* Could not get BASE mutex, wait for new to avoid blocking */
		return false;
	}

	if ((size_t)base_size != received_base_size ||
	    memcmp(base, received_base, (size_t)base_size) != 0) {
		(void)memcpy(received_base, base, base_size);
		received_base_size = (size_t)base_size;
	}
	err = k_mutex_unlock(&base_store_mutex);
	__ASSERT_NO_MSG(err == 0);

	/* Stop parsing */
	k_sem_give(&sem_received_base_subgroups);
	return false;
}

static void pa_recv(struct bt_le_per_adv_sync *sync,
			 const struct bt_le_per_adv_sync_recv_info *info,
			 struct net_buf_simple *buf)
{
	ARG_UNUSED(sync);
	ARG_UNUSED(info);

	bt_data_parse(buf, base_store, NULL);
}

static bool add_pa_sync_base_subgroup_bis_cb(const struct bt_bap_base_subgroup_bis *bis,
					     void *user_data)
{
	struct bt_bap_bass_subgroup *subgroup_param = user_data;

	subgroup_param->bis_sync |= BT_ISO_BIS_INDEX_BIT(bis->index);

	return true;
}

static bool add_pa_sync_base_subgroup_cb(const struct bt_bap_base_subgroup *subgroup,
					 void *user_data)
{
	struct bt_bap_broadcast_assistant_add_src_param *param = user_data;
	struct bt_bap_bass_subgroup *subgroup_param;
	uint8_t *data;
	int ret;

	ret = bt_bap_base_get_subgroup_codec_meta(subgroup, &data);
	if (ret < 0) {
		return false;
	}

	subgroup_param = param->subgroups;

	if (ret > ARRAY_SIZE(subgroup_param->metadata)) {
		printk("Cannot fit %d octets into subgroup param with size %zu", ret,
		       ARRAY_SIZE(subgroup_param->metadata));
		return false;
	}

	ret = bt_bap_base_subgroup_foreach_bis(subgroup, add_pa_sync_base_subgroup_bis_cb,
					       subgroup_param);
	if (ret < 0) {
		return false;
	}

	param->num_subgroups++;

	return true;
}

static bool is_substring(const char *substr, const char *str)
{
	const size_t str_len = strlen(str);
	const size_t sub_str_len = strlen(substr);

	if (sub_str_len > str_len) {
		return false;
	}

	for (size_t pos = 0U; pos < str_len; pos++) {
		if (pos + sub_str_len > str_len) {
			return false;
		}

		if (strncasecmp(substr, &str[pos], sub_str_len) == 0) {
			return true;
		}
	}

	return false;
}

static uint16_t interval_to_sync_timeout(uint16_t pa_interval)
{
	uint16_t pa_timeout;

	if (pa_interval == BT_BAP_PA_INTERVAL_UNKNOWN) {
		/* Use maximum value to maximize chance of success */
		pa_timeout = BT_GAP_PER_ADV_MAX_TIMEOUT;
	} else {
		uint32_t interval_us;
		uint32_t timeout;

		/* Add retries and convert to unit in 10's of ms */
		interval_us = BT_GAP_PER_ADV_INTERVAL_TO_US(pa_interval);
		timeout = BT_GAP_US_TO_PER_ADV_SYNC_TIMEOUT(interval_us) *
			  PA_SYNC_INTERVAL_TO_TIMEOUT_RATIO;

		/* Enforce restraints */
		pa_timeout = CLAMP(timeout, BT_GAP_PER_ADV_MIN_TIMEOUT, BT_GAP_PER_ADV_MAX_TIMEOUT);
	}

	return pa_timeout;
}

static int pa_sync_create(void)
{
	struct bt_le_per_adv_sync_param create_params = {0};
	struct bt_le_local_features feature;
	int err;

	err = bt_le_get_local_features(&feature);
	if (err < 0) {
		printk("Failed to get local le features (err %d)\n", err);
		return err;
	}

	bt_addr_le_copy(&create_params.addr, &selected_addr);
	if (BT_FEAT_LE_PER_ADV_ADI_SUPP(feature.features)) {
		create_params.options = BT_LE_PER_ADV_SYNC_OPT_FILTER_DUPLICATE;
	} else {
		create_params.options = BT_LE_PER_ADV_SYNC_OPT_NONE;
	}
	create_params.sid = selected_sid;
	create_params.skip = PA_SYNC_SKIP;
	create_params.timeout = interval_to_sync_timeout(selected_pa_interval);

	return bt_le_per_adv_sync_create(&create_params, &pa_sync);
}

static void scan_recv_cb(const struct bt_le_scan_recv_info *info,
			 struct net_buf_simple *ad)
{
	int err;

	if (scanning_for_broadcast_source) {
		struct broadcast_source_info bsrc_info = {0};

		/* Scan for and select Broadcast Source */

		bsrc_info.broadcast_id = BT_BAP_INVALID_BROADCAST_ID;

		/* We are only interested in non-connectable periodic advertisers */
		if ((info->adv_props & BT_GAP_ADV_PROP_CONNECTABLE) != 0 ||
		    info->interval == 0) {
			return;
		}

		bt_data_parse(ad, parse_broadcast_source_data, (void *)&bsrc_info);

		if (bsrc_info.broadcast_id != BT_BAP_INVALID_BROADCAST_ID) {
			printk("Broadcast Source Found:\n");
			printk("  BT Name:        %s\n", bsrc_info.bt_name);
			printk("  Broadcast Name: %s\n", bsrc_info.broadcast_name);
			printk("  Broadcast ID:   0x%06x\n\n", bsrc_info.broadcast_id);

#if defined(CONFIG_SELECT_SOURCE_NAME)
			if (strlen(CONFIG_SELECT_SOURCE_NAME) > 0U) {
				/* Compare names with CONFIG_SELECT_SOURCE_NAME */
				if (is_substring(CONFIG_SELECT_SOURCE_NAME, bsrc_info.bt_name) ||
				    is_substring(CONFIG_SELECT_SOURCE_NAME,
						 bsrc_info.broadcast_name)) {
					printk("Match found for '%s'\n", CONFIG_SELECT_SOURCE_NAME);
				} else {
					printk("'%s' not found in names\n\n",
					       CONFIG_SELECT_SOURCE_NAME);
					return;
				}
			}
#endif /* CONFIG_SELECT_SOURCE_NAME */

			err = bt_le_scan_stop();
			if (err != 0) {
				printk("bt_le_scan_stop failed with %d\n", err);
			}

			/* TODO: Add support for syncing to the PA and parsing the BASE
			 * in order to obtain the right subgroup information to send to
			 * the sink when adding a broadcast source (see in main function below).
			 */

			printk("Selecting Broadcast ID: 0x%06x\n", bsrc_info.broadcast_id);

			selected_broadcast_id = bsrc_info.broadcast_id;
			selected_sid = info->sid;
			selected_pa_interval = info->interval;
			bt_addr_le_copy(&selected_addr, info->addr);

			k_sem_give(&sem_source_discovered);

			printk("Attempting to PA sync to the broadcaster with id 0x%06X\n",
			       selected_broadcast_id);
		}
	} else {
		/* Scan for and connect to Broadcast Sink / Scan Delegator */
		struct scan_delegator_info sd_info = {0};

		/* We are only interested in connectable advertisers */
		if ((info->adv_props & BT_GAP_ADV_PROP_CONNECTABLE) == 0) {
			return;
		}

		bt_data_parse(ad, parse_scan_delegator_data, (void *)&sd_info);

		if (sd_info.has_svc_data) {
			printk("Broadcast Sink Found:\n");
			printk("  BT Name:        %s\n", sd_info.bt_name);

			if (strlen(CONFIG_SELECT_SINK_NAME) > 0U) {
				/* Compare names with CONFIG_SELECT_SINK_NAME */
				if (is_substring(CONFIG_SELECT_SINK_NAME, sd_info.bt_name)) {
					printk("Match found for '%s'\n", CONFIG_SELECT_SINK_NAME);
				} else {
					printk("'%s' not found in names\n\n",
					       CONFIG_SELECT_SINK_NAME);
					return;
				}
			}

			err = bt_le_scan_stop();
			if (err != 0) {
				printk("bt_le_scan_stop failed with %d\n", err);
			}

			printk("Connecting to Broadcast Sink: %s\n", sd_info.bt_name);

			err = bt_conn_le_create(info->addr, BT_CONN_LE_CREATE_CONN,
						BT_BAP_CONN_PARAM_RELAXED, &broadcast_sink_conn);
			if (err != 0) {
				printk("Failed creating connection (err=%u)\n", err);
				scan_for_broadcast_sink();
			}

			k_sem_give(&sem_sink_discovered);
		}
	}
}

static void scan_timeout_cb(void)
{
	printk("Scan timeout\n");
}

static struct bt_le_scan_cb scan_callbacks = {
	.recv = scan_recv_cb,
	.timeout = scan_timeout_cb,
};

static void scan_for_broadcast_source(void)
{
	int err;

	scanning_for_broadcast_source = true;

	err = bt_le_scan_start(BT_LE_SCAN_PASSIVE_CONTINUOUS, NULL);
	if (err != 0) {
		printk("Scanning failed to start (err %d)\n", err);
		return;
	}

	printk("Scanning for Broadcast Source successfully started\n");

	err = k_sem_take(&sem_source_discovered, K_FOREVER);
	__ASSERT_NO_MSG(err == 0);
}

static void scan_for_broadcast_sink(void)
{
	int err;

	scanning_for_broadcast_source = false;

	err = bt_le_scan_start(BT_LE_SCAN_PASSIVE_CONTINUOUS, NULL);
	if (err != 0) {
		printk("Scanning failed to start (err %d)\n", err);
		return;
	}

	printk("Scanning for Broadcast Sink successfully started\n");

	err = k_sem_take(&sem_sink_discovered, K_FOREVER);
	__ASSERT_NO_MSG(err == 0);
}

static void connected(struct bt_conn *conn, uint8_t err)
{
	if (err != 0) {
		printk("Failed to connect to %s %u %s\n", bt_conn_dst_str(conn),
		       err, bt_hci_err_to_str(err));

		bt_conn_drop(&broadcast_sink_conn);

		scan_for_broadcast_sink();
		return;
	}

	if (conn != broadcast_sink_conn) {
		return;
	}

	printk("Connected: %s\n", bt_conn_dst_str(conn));
	k_sem_give(&sem_sink_connected);
}

static void disconnected(struct bt_conn *conn, uint8_t reason)
{
	if (conn != broadcast_sink_conn) {
		return;
	}

	printk("Disconnected: %s, reason 0x%02x %s\n", bt_conn_dst_str(conn),
	       reason, bt_hci_err_to_str(reason));

	bt_conn_drop(&broadcast_sink_conn);

	k_sem_give(&sem_sink_disconnected);
}

static void security_changed_cb(struct bt_conn *conn, bt_security_t level,
				enum bt_security_err err)
{
	ARG_UNUSED(conn);

	if (err == 0) {
		printk("Security level changed: %u\n", level);
		k_sem_give(&sem_security_updated);
	} else {
		printk("Failed to set security level: %s(%u)\n", bt_security_err_to_str(err), err);
	}
}

static void bap_broadcast_assistant_discover_cb(struct bt_conn *conn, int err,
						uint8_t recv_state_count)
{
	ARG_UNUSED(conn);

	if (err == 0) {
		printk("BASS discover done with %u recv states\n",
		       recv_state_count);
		remote_recv_state_count = recv_state_count;
		k_sem_give(&sem_bass_discovered);
	} else {
		printk("BASS discover failed (%d)\n", err);
	}
}

static void bap_broadcast_assistant_add_src_cb(struct bt_conn *conn, int err)
{
	ARG_UNUSED(conn);

	if (err == 0) {
		printk("BASS add source successful\n");
	} else {
		printk("BASS add source failed (%d)\n", err);
	}
}

static void
bap_broadcast_assistant_recv_state_read_cb(struct bt_conn *conn, int err,
					   const struct bt_bap_scan_delegator_recv_state *state)
{
	ARG_UNUSED(conn);

	if (err != 0) {
		printk("BASS recv state read failed (%d)\n", err);
		return;
	}

	if (state != NULL) {
		printk("BASS recv state: src_id %u, addr %s, sid %u, sync_state %u, encrypt_state "
		       "%u, num_subgroups %u\n", state->src_id, bt_addr_le_str(&state->addr),
		       state->adv_sid, state->pa_sync_state, state->encrypt_state,
		       state->num_subgroups);

		for (uint8_t i = 0U; i < state->num_subgroups; i++) {
			const struct bt_bap_bass_subgroup *subgroup = &state->subgroups[i];

			printk("\t[%d]: BIS sync %u, metadata_len %u\n", i, subgroup->bis_sync,
			       subgroup->metadata_len);
		}
	} /* else empty receive state */

	k_sem_give(&sem_recv_state_read);
}

static void pa_sync_synced_cb(struct bt_le_per_adv_sync *sync,
			      struct bt_le_per_adv_sync_synced_info *info)
{
	ARG_UNUSED(info);

	if (sync == pa_sync) {
		printk("PA sync %p synced for broadcast sink with broadcast ID 0x%06X\n", sync,
		       selected_broadcast_id);

		k_sem_give(&sem_pa_synced);
	}
}
static void pa_sync_term_cb(struct bt_le_per_adv_sync *sync,
			    const struct bt_le_per_adv_sync_term_info *info)
{
	if (sync == pa_sync) {
		printk("PA sync %p terminated with reason %u\n", sync, info->reason);

		k_sem_give(&sem_pa_sync_terminted);
		pa_sync = NULL;
	}
}

static struct bt_bap_broadcast_assistant_cb ba_cbs = {
	.discover = bap_broadcast_assistant_discover_cb,
	.add_src = bap_broadcast_assistant_add_src_cb,
	.recv_state = bap_broadcast_assistant_recv_state_read_cb,
};

static struct bt_le_per_adv_sync_cb pa_synced_cb = {
	.synced = pa_sync_synced_cb,
	.term = pa_sync_term_cb,
	.recv = pa_recv,
};

static void reset(void)
{
	int err;

	printk("\n\nResetting...\n\n");

	if (broadcast_sink_conn != NULL) {
		err = bt_conn_disconnect(broadcast_sink_conn, BT_HCI_ERR_REMOTE_USER_TERM_CONN);

		if (err != 0) {
			printk("bt_conn_disconnect failed with %d\n", err);
		} else {
			if (k_sem_take(&sem_sink_disconnected, SEM_TIMEOUT) != 0) {
				/* This should not happen */

				__ASSERT_NO_MSG(false);
			}
		}
		__ASSERT_NO_MSG(err == 0);
	}

	/* Ignore return value as scanning may already be stopped */
	(void)bt_le_scan_stop();

	if (pa_sync != NULL) {
		err = bt_le_per_adv_sync_delete(pa_sync);

		if (err != 0) {
			printk("bt_le_per_adv_sync_delete failed with %d\n", err);
		} else {
			if (k_sem_take(&sem_pa_sync_terminted, SEM_TIMEOUT) != 0) {
				/* This should not happen */

				__ASSERT_NO_MSG(false);
			}
		}
		__ASSERT_NO_MSG(err == 0);
	}

	selected_broadcast_id = BT_BAP_INVALID_BROADCAST_ID;
	selected_sid = 0U;
	selected_pa_interval = 0U;
	(void)memset(&selected_addr, 0, sizeof(selected_addr));

	k_sem_reset(&sem_source_discovered);
	k_sem_reset(&sem_sink_discovered);
	k_sem_reset(&sem_sink_connected);
	k_sem_reset(&sem_sink_disconnected);
	k_sem_reset(&sem_security_updated);
	k_sem_reset(&sem_bass_discovered);
	k_sem_reset(&sem_pa_synced);
	k_sem_reset(&sem_received_base_subgroups);
}

BT_CONN_CB_DEFINE(conn_callbacks) = {
	.connected = connected,
	.disconnected = disconnected,
	.security_changed = security_changed_cb
};

static int read_recv_states(void)
{
	/* Attempts to read all found receive states - Some or all may be empty */
	for (uint8_t i = 0U; i < remote_recv_state_count; i++) {
		int err;

		err = bt_bap_broadcast_assistant_read_recv_state(broadcast_sink_conn, i);

		if (err != 0) {
			printk("Failed to read receive state[%u]: %d\n", i, err);

			return err;
		}

		err = k_sem_take(&sem_recv_state_read, SEM_TIMEOUT);
		if (err != 0) {
			printk("Failed to take sem_recv_state_read: %d\n", err);

			return err;
		}
	}

	return 0;
}

int main(void)
{
	int err;

	err = bt_enable(NULL);
	if (err != 0) {
		printk("Bluetooth init failed (err %d)\n", err);
		return 0;
	}

	printk("Bluetooth initialized\n");

	bt_bap_broadcast_assistant_register_cb(&ba_cbs);
	bt_le_per_adv_sync_cb_register(&pa_synced_cb);
	bt_le_scan_cb_register(&scan_callbacks);

	k_mutex_init(&base_store_mutex);

	while (true) {
		struct bt_bap_broadcast_assistant_add_src_param param = {0};

		reset();

		scan_for_broadcast_sink();

		err = k_sem_take(&sem_sink_connected, SEM_TIMEOUT);
		if (err != 0) {
			printk("Failed to take sem_sink_connected (err %d)\n", err);
			continue;
		}

		err = bt_conn_set_security(broadcast_sink_conn, BT_SECURITY_L2);
		if (err != 0) {
			printk("Failed to set security: %d\n", err);
			continue;
		}

		err = k_sem_take(&sem_security_updated, SEM_TIMEOUT);
		if (err != 0) {
			printk("Failed to take sem_security_updated (err %d)\n", err);
			continue;
		}

		err = bt_bap_broadcast_assistant_discover(broadcast_sink_conn);
		if (err != 0) {
			printk("Failed to discover BASS on the sink (err %d)\n", err);
			continue;
		}

		err = k_sem_take(&sem_bass_discovered, SEM_TIMEOUT);
		if (err != 0) {
			printk("Failed to take sem_bass_discovered (err %d)\n", err);
			continue;
		}

		err = read_recv_states();
		if (err != 0) {
			printk("Failed to read receive states\n");
			continue;
		}

		/* TODO: Discover and parse the PACS on the sink and use the information
		 * when discovering and adding a source to the sink.
		 * Also, before populating the parameters to sync to the broadcast source
		 * first, parse the source BASE and determine if the sink supports the source.
		 * If not, then look for another source.
		 */

		scan_for_broadcast_source();

		printk("Attempting to PA sync to the broadcaster with id 0x%06X\n",
		       selected_broadcast_id);
		err = pa_sync_create();
		if (err != 0) {
			printk("Could not create Broadcast PA sync: %d\n", err);
			continue;
		}

		printk("Waiting for PA synced\n");
		err = k_sem_take(&sem_pa_synced, SEM_TIMEOUT);
		if (err != 0) {
			printk("Failed to take sem_pa_synced (err %d)\n", err);
			continue;
		}

		memset(bass_subgroups, 0, sizeof(bass_subgroups));
		bt_addr_le_copy(&param.addr, &selected_addr);
		param.adv_sid = selected_sid;
		param.pa_interval = selected_pa_interval;
		param.broadcast_id = selected_broadcast_id;
		param.pa_sync = true;
		param.subgroups = bass_subgroups;

		/* Wait to receive subgroups */
		err = k_sem_take(&sem_received_base_subgroups, K_FOREVER);
		__ASSERT_NO_MSG(err == 0);

		err = k_mutex_lock(&base_store_mutex, K_FOREVER);
		__ASSERT_NO_MSG(err == 0);
		err = bt_bap_base_foreach_subgroup((const struct bt_bap_base *)received_base,
						   add_pa_sync_base_subgroup_cb, &param);
		err = k_mutex_unlock(&base_store_mutex);
		__ASSERT_NO_MSG(err == 0);

		if (err != 0) {
			printk("Could not add BASE to params %d\n", err);
			continue;
		}

		err = bt_bap_broadcast_assistant_add_src(broadcast_sink_conn, &param);
		if (err != 0) {
			printk("Failed to add source: %d\n", err);
			continue;
		}

		/* Reset if the sink disconnects */
		err = k_sem_take(&sem_sink_disconnected, K_FOREVER);
		__ASSERT_NO_MSG(err == 0);
	}

	return 0;
}
```
